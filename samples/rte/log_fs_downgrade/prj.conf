## CMakeLists.txt
```
# Copyright (c) 2026 SYSTech Co.
# SPDX-License-Identifier: Apache-2.0

cmake_minimum_required(VERSION 3.20.0)

find_package(Zephyr REQUIRED HINTS $ENV{ZEPHYR_BASE})
project(rte_log_fs_downgrade)

target_sources(app PRIVATE src/main.c)
```

## sample.yaml
```
sample:
  description: rbs2530 LOG_BACKEND_FS downgrade verification sample
  name: rbs2530 log fs downgrade
common:
  tags:
    - logging
    - filesystem
    - rte
tests:
  sample.rbs2530.rte.log_fs_downgrade:
    tags:
      - logging
      - filesystem
      - rte
    platform_allow:
      - rbs2530_cpu
```

## prj.conf
```kconfig
CONFIG_LOG=y
CONFIG_LOG_MODE_DEFERRED=y
CONFIG_LOG_BACKEND_UART=y
CONFIG_LOG_BACKEND_FS=y
CONFIG_LOG_BACKEND_FS_DIR="/lfs"
CONFIG_LOG_BACKEND_FS_FILE_SIZE=1048576
CONFIG_LOG_BACKEND_FS_FILES_LIMIT=4
CONFIG_LOG_BACKEND_FS_DEGRADE_FAILURE_THRESHOLD=3
CONFIG_LOG_BACKEND_FS_DEGRADE_PRINTK_INTERVAL_MS=5000
CONFIG_LOG_MAX_LEVEL=4

CONFIG_PRINTK=y
CONFIG_MAIN_STACK_SIZE=8192
CONFIG_SYSTEM_WORKQUEUE_STACK_SIZE=8192

CONFIG_FILE_SYSTEM=y
CONFIG_FILE_SYSTEM_LITTLEFS=y
```

## boards/rbs2530_cpu.conf
```kconfig
# rbs2530_cpu eMMC LittleFS configuration
CONFIG_GPIO=y
CONFIG_SDHC=y
CONFIG_MMC_STACK=y

CONFIG_DISK_DRIVERS=y
CONFIG_DISK_ACCESS=y
CONFIG_DISK_DRIVER_MMC=y

CONFIG_FILE_SYSTEM=y
CONFIG_FILE_SYSTEM_LITTLEFS=y
CONFIG_FS_LITTLEFS_BLK_DEV=y
CONFIG_FS_LITTLEFS_CACHE_SIZE=512
CONFIG_FS_LITTLEFS_HEAP_PER_ALLOC_OVERHEAD_SIZE=128

CONFIG_ARM_MMU_NUM_L2_TABLES=1024
CONFIG_NOCACHE_MEMORY=y
CONFIG_SERIAL_INIT_PRIORITY=50

CONFIG_MAIN_STACK_SIZE=8192
CONFIG_SYSTEM_WORKQUEUE_STACK_SIZE=8192
```

## src/main.c
```c
/*
 * Copyright (c) 2026 SYSTech Co.
 *
 * SPDX-License-Identifier: Apache-2.0
 */

#include <zephyr/fs/fs.h>
#include <zephyr/fs/littlefs.h>
#include <zephyr/kernel.h>
#include <zephyr/logging/log.h>
#include <zephyr/logging/log_backend_fs.h>
#include <zephyr/sd/sd_spec.h>

LOG_MODULE_REGISTER(log_fs_downgrade, LOG_LEVEL_DBG);

#define STATUS_PRINT_INTERVAL_MS 5000
#define LOG_INTERVAL_MS          100

static int fs_default_mount(void);

FS_LITTLEFS_DECLARE_CUSTOM_CONFIG(lfs_data, CONFIG_SDHC_BUFFER_ALIGNMENT, SDMMC_DEFAULT_BLOCK_SIZE,
				  SDMMC_DEFAULT_BLOCK_SIZE, SDMMC_DEFAULT_BLOCK_SIZE,
				  2 * SDMMC_DEFAULT_BLOCK_SIZE);

#if defined(CONFIG_DISK_DRIVER_SDMMC)
#define DISK_NAME CONFIG_SDMMC_VOLUME_NAME
#elif defined(CONFIG_DISK_DRIVER_MMC)
#define DISK_NAME CONFIG_MMC_VOLUME_NAME
#else
#error "No disk device defined, is your board supported?"
#endif

static struct fs_mount_t littlefs_mnt = {
	.type = FS_LITTLEFS,
	.fs_data = &lfs_data,
	.flags = FS_MOUNT_FLAG_USE_DISK_ACCESS,
	.storage_dev = DISK_NAME,
	.mnt_point = CONFIG_LOG_BACKEND_FS_DIR,
};

int main(void)
{
	uint32_t counter = 0;
	int64_t next_status = k_uptime_get();
	int rc;

	printk("log_fs_downgrade: board=%s dir=%s file_size=%d files=%d threshold=%d\n",
	       CONFIG_BOARD_TARGET, CONFIG_LOG_BACKEND_FS_DIR, CONFIG_LOG_BACKEND_FS_FILE_SIZE,
	       CONFIG_LOG_BACKEND_FS_FILES_LIMIT, CONFIG_LOG_BACKEND_FS_DEGRADE_FAILURE_THRESHOLD);

	rc = fs_default_mount();
	if (rc < 0) {
		printk("log_fs_downgrade: mount failed rc=%d\n", rc);
		return rc;
	}

	while (true) {
		LOG_INF("log_fs_downgrade counter=%u payload=%08x%08x%08x%08x", counter, counter,
			counter + 1, counter + 2, counter + 3);

		if (k_uptime_get() >= next_status) {
			printk("log_fs_downgrade: degraded=%d failures=%u last_error=%d\n",
			       log_backend_fs_is_degraded(), log_backend_fs_failure_count_get(),
			       log_backend_fs_last_error_get());
			next_status += STATUS_PRINT_INTERVAL_MS;
		}

		counter++;
		k_msleep(LOG_INTERVAL_MS);
	}

	return 0;
}

static int fs_default_mount(void)
{
	int rc;

	rc = fs_mount(&littlefs_mnt);
	if (rc < 0) {
		LOG_ERR("FAIL: mount id %" PRIuPTR " at %s: %d",
			(uintptr_t)(littlefs_mnt.storage_dev), littlefs_mnt.mnt_point, rc);
		return rc;
	}

	LOG_INF("%s mount: %d", littlefs_mnt.mnt_point, rc);
	return 0;
}
```
