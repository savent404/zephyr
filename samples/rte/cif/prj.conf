## CMakeLists.txt
```
# SPDX-License-Identifier: Apache-2.0

cmake_minimum_required(VERSION 3.20.0)

find_package(Zephyr REQUIRED HINTS $ENV{ZEPHYR_BASE})
project(rte_cif)

target_include_directories(app PRIVATE inc)
target_sources(app PRIVATE src/main.c)
target_sources(app PRIVATE src/main_master.c)
target_sources(app PRIVATE src/main_slave.c)
```

## Kconfig
```
# Copyright (c) 2025 SYSTech Co.
# SPDX-License-Identifier: Apache-2.0

mainmenu "cif"

module = CIF
module-str = cif
source "subsys/logging/Kconfig.template.log_config"

config CIF_SLAVE_ONLY_RECV
	bool "Enable slave only receive mode"
	help
	  Enable slave only receive mode. In this mode, the CIF will not send any data to the master.
	  This is useful for testing purposes or when the master is not available.

config CIF_SAMPLE_FAULT_INJECT
	bool "Enable sample-only slave fault injection shell"
	default n
	depends on SHELL
	help
	  Enable the sample-only top-level `cif_fault` shell command for deterministic
	  slave-side recv/send delay injection during issue3 validation.

config CIF_ISSUE3_LATENCY_LOG
	bool "Enable issue3 async latency logging"
	default n
	depends on LOG
	help
	  Emit per-attempt ISSUE3_LAT logs from the sample master async path. Keep this
	  disabled for acceptance and enable it only for targeted measurement images.

config CIF_SYNC_CYCLE_TIME_US
	int "Sync cycle time (us)"
	default 10000
	range 1 1000000
	help
	  Sync cycle time used by the CIF sample master and slave loops.

config CIF_ASYNC_INTERVAL_TIME_US
	int "Async interval time (us)"
	default 40000
	range 1 1000000
	help
	  Async interval time used by the CIF sample master.

source "Kconfig.zephyr"
```

## sample.yaml
```
sample:
  description: rbs2530 cif sample
  name: rbs2530 cif
common:
  tags: app
tests:
  sample.rbs2530.rte.cif:
    tags: app
    platform_allow:
      - rbs2530_cpu
      - rbs2530_ec
      - rbs2530_ext
```

## prj.conf
```kconfig
# Generic networking options
CONFIG_NETWORKING=y
CONFIG_NET_SOCKETS=y
CONFIG_POSIX_API=y
CONFIG_NET_DRIVERS=y
CONFIG_NET_SOCKETS=y
CONFIG_NET_SOCKETS_OFFLOAD=y
CONFIG_NET_NATIVE_OFFLOADED_SOCKETS=y

# shell options
CONFIG_SHELL=y

# Gneric kernel options
CONFIG_MAIN_STACK_SIZE=4096
CONFIG_HEAP_MEM_POOL_SIZE=26214400
CONFIG_COMMON_LIBC_MALLOC_ARENA_SIZE=26214400

# Logging
CONFIG_NET_LOG=y
CONFIG_LOG=y
CONFIG_ASSERT=n
CONFIG_NET_STATISTICS=y
CONFIG_PRINTK=y
CONFIG_LOG_SPEED=n
CONFIG_LOG_BUFFER_SIZE=65536
CONFIG_LOG_PROCESS_THREAD_SLEEP_MS=50
CONFIG_LOG_BLOCK_IN_THREAD=y
CONFIG_LOG_CMDS=y

# CIF specific options
CONFIG_NET_SOCKETS_CIF=y
CONFIG_STD_CPP20=y

# CIF performance options
CONFIG_SYS_CLOCK_TICKS_PER_SEC=100000
CONFIG_LDP_MAX_HARQ=32

# Enable trace
CONFIG_USE_SEGGER_RTT=y
CONFIG_TRACING=y
CONFIG_SEGGER_SYSTEMVIEW=y
CONFIG_TRACING_BUFFER_SIZE=65536
CONFIG_SEGGER_SYSVIEW_RTT_BUFFER_SIZE=65536

CONFIG_THREAD_ANALYZER=y
# CONFIG_THREAD_ANALYZER_AUTO=y # too noisy
CONFIG_THREAD_ANALYZER_AUTO_INTERVAL=10
CONFIG_THREAD_ANALYZER_USE_PRINTK=y
CONFIG_SPEED_OPTIMIZATIONS=y

CONFIG_THREAD_RUNTIME_STATS_OVERFLOW_PROTECTION=y
```

## boards/qemu_x86.overlay
```dts
#include <freq.h>
/ {
	mcb0: mcb@0 {
		compatible = "systech,mcb";
		reg = <0x20000000 DT_SIZE_K(4)
			   0x30000000 DT_SIZE_K(512)
			   0x40000000 DT_SIZE_K(512)>;
		reg-names = "reg", "rx_buf", "tx_buf";
		status = "okay";
		bandwidth = <DT_FREQ_M(1)>;
	};

	mcb1: mcb@1 {
		compatible = "systech,mcb";
		reg = <0x20000000 DT_SIZE_K(4)
			   0x30000000 DT_SIZE_K(512)
			   0x40000000 DT_SIZE_K(512)>;
		reg-names = "reg", "rx_buf", "tx_buf";
		status = "okay";
		bandwidth = <DT_FREQ_M(40)>;
	};
	aliases {
		mcbl = &mcb0;
		mcbh = &mcb1;
	};
};
```

## boards/rbs2530_cpu.overlay
```dts
&mcb0 {
	status = "okay";
};

&mcb1 {
	status = "okay";
};

/ {
	aliases {
		mcbl = &mcb0;
		mcbh = &mcb1;
	};
};
```

## src/main.c
```c
/**
 * @file main.c
 * @author Liao YuanKai(savent_gate@outlook.com)
 * @brief
 * @version 0.1
 * @date 2025-01-28
 *
 * @copyright Copyright (c) 2025 SYSTech Co.
 *
 */
#include <zephyr/shell/shell.h>
#include <zephyr/kernel.h>
#include <string.h>
#include <stdlib.h>

#include "cif_main.h"

struct context ctx_ = {0};

struct open_port_s open_ports[MAX_OPEN_PORTS];

K_MSGQ_DEFINE(cif_cmd_msgq, sizeof(struct cif_cmd_req), CIF_CMD_QUEUE_DEPTH, 4);

int cif_cmd_enqueue(const struct cif_cmd_req *req)
{
	return k_msgq_put(&cif_cmd_msgq, req, K_NO_WAIT);
}

bool cif_cmd_dequeue(struct cif_cmd_req *req)
{
	return k_msgq_get(&cif_cmd_msgq, req, K_NO_WAIT) == 0;
}

void cif_cmd_queue_reset(void)
{
	k_msgq_purge(&cif_cmd_msgq);
	ctx_.cmd = CMD_NONE;
}

int main(void)
{
	/* log needs to be initialized first */
	k_msleep(100);

	ctx_.target_role = role_slave;
	slave_start();

	return 0;
}

static void unconditional_switch(int role)
{
	cif_cmd_queue_reset();

	/* Cancel current role */
	if (ctx_.target_role == role_master) {
		master_cancel();
	} else {
		slave_cancel();
	}

	/* Start new role */
	if (role == role_master) {
		master_start();
	} else if (role == role_slave) {
		slave_start();
	}
	ctx_.target_role = role;
}

static int enqueue_cmd_or_report(const struct shell *sh, const struct cif_cmd_req *req)
{
	int ret = cif_cmd_enqueue(req);

	if (ret != 0) {
		shell_print(sh, "Command queue full");
		return -ENOMEM;
	}

	return 0;
}

static int cif_cmd(const struct shell *sh, size_t argc, char **argv)
{
	bool handled = false;
	struct cif_cmd_req req = {0};
	enum {
		_cmd_none = CMD_NONE,
		_cmd_discovery = CMD_DISCOVERY,
		_cmd_config = CMD_CONFIG,
		_cmd_io = CMD_IO,
		_cmd_switch = CMD_SWITCH,
		_cmd_open = CMD_OPEN,
		_cmd_close = CMD_CLOSE,
		_cmd_perf = CMD_PERF,
		_cmd_list = CMD_LIST,
		_cmd_stat = CMD_STATS,
	} cmd = _cmd_none;
	const char *subcmd = argv[1];
	static const char *const subcmd_list[] = {
		"discovery", "config", "io", "switch", "open", "close", "perf", "list", "stats",
	};
	for (int i = 0; i < ARRAY_SIZE(subcmd_list); i++) {
		if (!strcmp(subcmd, subcmd_list[i])) {
			cmd = i + 1;
			break;
		}
	}
	switch (cmd) {
	case _cmd_discovery: {
		if (ctx_.target_role != role_master) {
			shell_print(sh, "Only master can discovery");
			return -EINVAL;
		}
		if (argc != 3) {
			shell_print(sh, "Invalid arguments number");
			return -EINVAL;
		}
		req.cmd = CMD_DISCOVERY;
		req.target_sid = atoi(argv[2]);
		if (enqueue_cmd_or_report(sh, &req) != 0) {
			return -ENOMEM;
		}
		handled = true;
	} break;
	case _cmd_config: {
		if (ctx_.target_role != role_master) {
			shell_print(sh, "Only master can config");
			return -EINVAL;
		}
		if (argc != 3) {
			shell_print(sh, "Invalid arguments number");
			return -EINVAL;
		}
		req.cmd = CMD_CONFIG;
		req.target_sid = atoi(argv[2]);
		req.target_opt = ctx_.target_opt;
		if (enqueue_cmd_or_report(sh, &req) != 0) {
			return -ENOMEM;
		}
		handled = true;
	} break;
	case _cmd_io: {
		if (ctx_.target_role != role_master) {
			shell_print(sh, "Only master can io");
			return -EINVAL;
		}
		if (argc < 3) {
			shell_print(sh, "Invalid arguments number");
			return -EINVAL;
		}
		req.cmd = CMD_IO;
		req.target_sid = atoi(argv[2]);
		req.target_opt = ctx_.target_opt;

		/* Handle port */
		if (argc >= 4) {
			req.target_port = atoi(argv[3]);
		} else {
			req.target_port = PORT_ID_IO;
		}

		/* Handle length */
		if (argc >= 5) {
			req.initial_data_len = atoi(argv[4]);
		} else {
			req.initial_data_len = 32;
		}

		/* Handle duration */
		if (argc >= 6) {
			req.target_duration = atoi(argv[5]) * 1000;
		} else {
			req.target_duration = 3 * 1000;
		}

		/* Handle pps */
		if (argc >= 7 && CIF_IS_ASYNC_PORT(req.target_port)) {
			req.target_pps = atoi(argv[6]);
		} else if (argc >= 7) {
			shell_print(sh, "Invalid port, try async port");
			return -EINVAL;
		}
		if (enqueue_cmd_or_report(sh, &req) != 0) {
			return -ENOMEM;
		}
		handled = true;
	} break;
	case _cmd_switch: {
		if (argc < 3) {
			shell_print(sh, "Current role: %s\n",
				    ctx_.target_role == role_master ? "master" : "slave");
			shell_print(sh, "Preempt: %s\n", ctx_.target_opt == normal ? "no" : "yes");
			handled = true;
			break;
		}
		bool is_master = !strcmp(argv[2], "master");
		bool is_slave = !strcmp(argv[2], "slave");

		if (!is_master && !is_slave) {
			shell_print(sh, "Invalid role, try slave or master");
			break;
		}
		ctx_.target_opt = normal;
		ctx_.target_bus = bus_low;
		ctx_.perf_mode = false;
		for (int i = 3; i < argc; i++) {
			if (!strcmp(argv[i], "preempt")) {
				ctx_.target_opt = preempt;
				break;
			} else if (!strcmp(argv[i], "bus_low")) {
				ctx_.target_bus = bus_low;
			} else if (!strcmp(argv[i], "bus_high")) {
				ctx_.target_bus = bus_high;
			} else {
				shell_print(sh, "Invalid option: %s", argv[i]);
				return -EINVAL;
			}
		}
		handled = true;
		unconditional_switch(is_master ? role_master : role_slave);
		break;
	}
	case _cmd_open: {
		if (ctx_.target_role != role_master) {
			shell_print(sh, "Only master can open ports");
			return -EINVAL;
		}
		if (argc < 4) {
			shell_print(sh, "Invalid arguments number");
			return -EINVAL;
		}
		req.cmd = CMD_OPEN;
		req.target_sid = atoi(argv[2]);
		req.target_port = atoi(argv[3]);
		req.target_opt = ctx_.target_opt;

		/* Handle initial data */
		if (argc >= 5) {
			strncpy((char *)req.initial_data, argv[4], sizeof(req.initial_data) - 1);
			req.initial_data_len = strlen(argv[4]);
		} else {
			/* Default initial data */
			strcpy((char *)req.initial_data, "init");
			req.initial_data_len = 4;
		}
		/* Handle check response option */
		if (argc >= 6 && !strcmp(argv[5], "check")) {
			req.check_response = true;
		} else {
			req.check_response = false;
		}
		if (enqueue_cmd_or_report(sh, &req) != 0) {
			return -ENOMEM;
		}
		handled = true;
		break;
	}
	case _cmd_close: {
		if (ctx_.target_role != role_master) {
			shell_print(sh, "Only master can close ports");
			return -EINVAL;
		}
		if (argc != 4) {
			shell_print(sh, "Invalid arguments number");
			return -EINVAL;
		}
		req.cmd = CMD_CLOSE;
		req.target_sid = atoi(argv[2]);
		req.target_port = atoi(argv[3]);
		if (enqueue_cmd_or_report(sh, &req) != 0) {
			return -ENOMEM;
		}
		handled = true;
		break;
	}
	case _cmd_perf: {
		if (argc != 3) {
			shell_print(sh, "Invalid arguments number");
			return -EINVAL;
		}
		if (!strcmp(argv[2], "on")) {
			ctx_.perf_mode = true;
		} else if (!strcmp(argv[2], "off")) {
			ctx_.perf_mode = false;
		} else {
			shell_print(sh, "Invalid arguments");
			return -EINVAL;
		}
		handled = true;
		break;
	}
	case _cmd_list: {
		shell_print(sh, "Open Ports:");
		for (int i = 0; i < MAX_OPEN_PORTS; i++) {
			if (open_ports[i].active) {
				uint32_t dur = k_uptime_get_32() - open_ports[i].open_timestamp;

				shell_print(
					sh,
					"SID: %d, Port: %d, Sent: %d(%d/s, lag: %d/%d), Received: "
					"%d(%d/s, lag: %d/%d), failed: "
					"%d, dur: %d",
					open_ports[i].sid, open_ports[i].port,
					open_ports[i].stat_sent,
					open_ports[i].stat_sent * 1000 / dur,
					open_ports[i].lag_tx_avg, open_ports[i].lag_tx_max,
					open_ports[i].stat_received,
					open_ports[i].stat_received * 1000 / dur,
					open_ports[i].lag_rx_avg, open_ports[i].lag_rx_max,
					open_ports[i].stat_error, dur);

				if (open_ports[i].prev_timestamp) {
					shell_print(
						sh,
						"curr rx: %d(%d/s), tx: %d(%d/s), err: %d, "
						"dur:%d\n",
						open_ports[i].stat_received -
							open_ports[i].prev_stat_received,
						(open_ports[i].stat_received -
						 open_ports[i].prev_stat_received) *
							1000 / (dur - open_ports[i].prev_timestamp),
						open_ports[i].stat_sent -
							open_ports[i].prev_stat_sent,
						(open_ports[i].stat_sent -
						 open_ports[i].prev_stat_sent) *
							1000 / (dur - open_ports[i].prev_timestamp),
						open_ports[i].stat_error -
							open_ports[i].prev_stat_error,
						dur - open_ports[i].prev_timestamp);
				}

				open_ports[i].prev_stat_received = open_ports[i].stat_received;
				open_ports[i].prev_stat_sent = open_ports[i].stat_sent;
				open_ports[i].prev_stat_error = open_ports[i].stat_error;
				open_ports[i].prev_timestamp = dur;
			}
		}
		handled = true;
		break;
	}
	case _cmd_stat: {
		if (ctx_.target_role != role_master) {
			shell_print(sh, "Only master can get stats");
			return -EINVAL;
		}
		req.cmd = CMD_STATS;
		if (enqueue_cmd_or_report(sh, &req) != 0) {
			return -ENOMEM;
		}
		handled = true;
		break;
	}
	case _cmd_none:
	default:
		break;
	}

	if (!handled) {
		shell_print(sh, "Unknown subcmd or invalid arguments number");
		shell_print(sh, "cmd: discovery, config, io, open, close");
		shell_print(sh, "\tdiscovery <slot>");
		shell_print(sh, "\tconfig <slot>");
		shell_print(sh, "\tio <slot> [port] [length:bytes] [duration:sec] [pps]");
		shell_print(sh, "\tswitch <slave|master> [preempt]");
		shell_print(sh, "\topen <slot> <port> [initial_data] [check]");
		shell_print(sh, "\tclose <slot> <port>");
		shell_print(sh, "\tlist");
		shell_print(sh, "\tperf on|off");
		shell_print(sh, "\tstats");
		return 0;
	}

	return 0;
}

SHELL_CMD_REGISTER(cif, NULL, "Dump version information", cif_cmd);
```

## inc/cif_main.h
```c
/**
 * @file main.h
 * @author Liao YuanKai (savent_gate@outlook.com)
 * @brief
 * @version 0.1
 * @date 2025-01-28
 *
 * @copyright Copyright (c) 2025 SYSTech Co.
 *
 */
#pragma once

#include <zephyr/net/socketcif.h>

#define MAX_DEV 2

#define MCB_POLL_TIME           (655 * 1000)                      /* 655us */
#define SYNC_CYCLE_TIME         CONFIG_CIF_SYNC_CYCLE_TIME_US     /* us */
#define SYNC_TIMEOUT_TIME       (SYNC_CYCLE_TIME * 5)             /* 5 cycles */
#define ASYNC_INTERVAL_TIME     CONFIG_CIF_ASYNC_INTERVAL_TIME_US /* us */
#define ASYNC_TIMEOUT_TIME      (200 * 1000)                      /* 200ms */
#define ASYNC_DEFAULT_BANDWIDTH 0                                 /* no limitation */

#if CONFIG_MCB_SYSTECH_HW_WORKAROUND
#define PORT_ID_DISC 0x00
#endif
#define PORT_ID_CFG  0x08
#define PORT_ID_IO   0x01
#define PORT_ID_ETH0 0x10
#define PORT_ID_ETH1 0x11
#define PORT_ID_ETH2 0x12
#define PORT_ID_ETH3 0x13

/* Make sure that compile is satisfied */
#define REG_BUF_REG_DEF(name, length)                                                              \
	static uint8_t name##_modify[length];                                                      \
	static uint8_t name##_reg[length]
#define REG_BUF_LEN(name)    name.len
#define REG_BUF_REG(name)    name.reg
#define REG_BUF_MODIFY(name) name.modify
#define REG_BUF_DEF(name, length)                                                                  \
	static struct reg_buf name = {                                                             \
		.reg = (uint8_t *)&name##_reg,                                                     \
		.modify = (uint8_t *)&name##_modify,                                               \
		.len = length,                                                                     \
	}

struct context {
	int target_sid;
	int target_port;
	uint32_t target_duration; /* unit: ms */
	uint32_t target_pps;
	enum {
		role_master,
		role_slave,
	} target_role;
	enum {
		bus_low,
		bus_high,
	} target_bus;
	enum {
		normal,
		preempt,
	} target_opt;

#define CMD_NONE      0
#define CMD_DISCOVERY 1
#define CMD_CONFIG    2
#define CMD_IO        3
#define CMD_SWITCH    4
#define CMD_OPEN      5
#define CMD_CLOSE     6
#define CMD_PERF      7
#define CMD_LIST      8
#define CMD_STATS     9
	uint32_t cmd;

#define STATE_IDLE     0
#define STATE_DISCOVER 1
#define STATE_CONFIG   2
#define STATE_IO_START 3
#define STATE_IO       4
#define STATE_OPEN     5
#define STATE_CLOSE    6
#define STATE_STATS    7
	uint32_t state;

	uint32_t stat_ok;
	uint32_t stat_failed;

	int64_t systick_begin;
	int64_t systick_end;

	struct sockaddr_cif curr;
	socklen_t curr_len;

	struct k_sem terminate_sem;

	/* For open command */
	uint8_t initial_data[64];
	size_t initial_data_len;
	bool check_response;

	bool perf_mode;
};

#define CIF_CMD_QUEUE_DEPTH 32

struct cif_cmd_req {
	uint32_t cmd;
	int target_sid;
	int target_port;
	uint32_t target_duration;
	uint32_t target_pps;
	int target_opt;
	uint8_t initial_data[64];
	size_t initial_data_len;
	bool check_response;
};

int cif_cmd_enqueue(const struct cif_cmd_req *req);
bool cif_cmd_dequeue(struct cif_cmd_req *req);
void cif_cmd_queue_reset(void);

int slave_start(void);
int slave_cancel(void);
int master_start(void);
int master_cancel(void);

/**
 * @brief This function is used to get and handle extra errors.
 * @return 1 if Preempt event detected. (For master mode, it shall switch to slave mode)
 * @return 0 if no extra errors detected.
 */
int handle_extra_errors(int sock);

#define MAX_OPEN_PORTS  16
#define MAX_OPEN_ERRORS 32
struct open_port_s {
	uint8_t sid;
	uint8_t port;
	bool active;
	uint32_t stat_sent;
	uint32_t stat_received;
	uint32_t stat_error;
	uint32_t open_timestamp;

	uint32_t prev_stat_sent;
	uint32_t prev_stat_received;
	uint32_t prev_stat_error;
	uint32_t prev_timestamp;
	uint32_t issue3_last_tx_us;
	bool issue3_waiting_rx;
	uint32_t lag_rx_avg;
	uint32_t lag_rx_max;
	uint32_t lag_tx_avg;
	uint32_t lag_tx_max;
};

extern struct open_port_s open_ports[MAX_OPEN_PORTS];
```

## src/main_master.c
```c
/**
 * @license This project is CLOSED SOURCE, All Rights Reserved
 * Copyright (c) 2025 SYSTech Co.
 */
#include <zephyr/kernel.h>
#include <zephyr/net/socket.h>
#include <zephyr/net/socketcif.h>
#include <zephyr/logging/log.h>
#include <string.h>

#include "cif_main.h"

LOG_MODULE_REGISTER(main_m, CONFIG_CIF_LOG_LEVEL);

extern struct context ctx_;

static bool parse_cmd(void)
{
	struct cif_cmd_req req;

	if (!cif_cmd_dequeue(&req)) {
		return false;
	}

	ctx_.cmd = req.cmd;
	ctx_.target_sid = req.target_sid;
	ctx_.target_port = req.target_port;
	ctx_.target_duration = req.target_duration;
	ctx_.target_pps = req.target_pps;
	ctx_.target_opt = req.target_opt;
	memcpy(ctx_.initial_data, req.initial_data, sizeof(ctx_.initial_data));
	ctx_.initial_data_len = req.initial_data_len;
	ctx_.check_response = req.check_response;

	switch (req.cmd) {
	case CMD_DISCOVERY:
		ctx_.state = STATE_DISCOVER;
		break;
	case CMD_CONFIG:
		ctx_.state = STATE_CONFIG;
		break;
	case CMD_IO:
		ctx_.state = STATE_IO_START;
		break;
	case CMD_OPEN:
		ctx_.state = STATE_OPEN;
		break;
	case CMD_CLOSE:
		ctx_.state = STATE_CLOSE;
		break;
	case CMD_STATS:
		ctx_.state = STATE_STATS;
		break;
	case CMD_NONE:
	default:
		break;
	}
	ctx_.cmd = CMD_NONE;
	return true;
}

static bool dev_discovery(int cif_sock, uint8_t slot)
{
	bool exist = true;

	struct cif_raw_port_config port_cfg = {
		.port = 0,
		.slot = slot,
		.flags = CIF_PORT_FLG_ENABLE | CIF_PORT_FLG_ONE_SHOT,
	};

	int ret = setsockopt(cif_sock, SOL_CIF_RAW, CIF_OPT_PORT, &port_cfg, sizeof(port_cfg));

	if (ret < 0) {
		LOG_ERR("Failed to configure CIF socket port, errno %d", errno);
		return false;
	}

	static uint8_t buf[CIF_MTU];
	struct sockaddr_cif addr = {
		.cif_family = AF_CIF,
		.slot = slot,
		.port = 0,
	};
	socklen_t addr_len = sizeof(addr);
	ssize_t len;

	/* NOTE: User Call rx() to trigger LDP start to transmit */
	recvfrom(cif_sock, buf, sizeof(buf), 0, (struct sockaddr *)&addr, &addr_len);

	/* Wait for LDP query discovery response automatically */
	k_usleep(SYNC_CYCLE_TIME * 2);

	len = recvfrom(cif_sock, buf, sizeof(buf), 0, (struct sockaddr *)&addr, &addr_len);

	if (len < 0) {
		LOG_ERR("Failed to receive data, errno %d", errno);
		exist = false;
	} else {
		LOG_ERR("Received %zd bytes", len);
		LOG_HEXDUMP_INF(buf, len, "Received data");
		exist = true;
	}

	/* close connection */
	port_cfg.flags &= ~CIF_PORT_FLG_ENABLE;
	ret = setsockopt(cif_sock, SOL_CIF_RAW, CIF_OPT_PORT, &port_cfg, sizeof(port_cfg));
	if (ret < 0) {
		LOG_ERR("Failed to configure CIF socket port, errno %d", errno);
	}

	return exist;
}

static bool dev_general_init(int cif_sock, uint8_t slot, uint8_t port, uint32_t ext_flg,
			     uint32_t pps)
{
	struct cif_raw_port_config port_cfg = {
		.port = port,
		.slot = slot,
		.flags = CIF_PORT_FLG_ENABLE | ext_flg,

		/** async configuration */
		.async_interval = ASYNC_INTERVAL_TIME,
		.async_timeout = ASYNC_TIMEOUT_TIME,
		.async_bandwidth = pps,
	};

	if (ext_flg & CIF_PORT_FLG_PREEMPT) {
		LOG_INF("Preempt mode enabled, need to close the port to reset it. (via "
			"setsockopt(flags=0) or close socket)");
	}

	int ret = setsockopt(cif_sock, SOL_CIF_RAW, CIF_OPT_PORT, &port_cfg, sizeof(port_cfg));

	if (ret < 0) {
		LOG_ERR("Failed to configure CIF socket port, errno %d", errno);
		return false;
	}
	return true;
}

static bool dev_general_deinit(int cif_sock, uint8_t slot, uint8_t port)
{
	struct cif_raw_port_config port_cfg = {
		.port = port,
		.slot = slot,
		.flags = 0,
	};

	int ret = setsockopt(cif_sock, SOL_CIF_RAW, CIF_OPT_PORT, &port_cfg, sizeof(port_cfg));

	if (ret < 0) {
		LOG_ERR("Failed to configure CIF socket port, errno %d", errno);
		return false;
	}
	return true;
}

static bool dev_general_cfg(int cif_sock, uint8_t slot, uint8_t port, const void *cfg, size_t len)
{
	char response[64];
	struct sockaddr_cif remote = {
		.cif_family = AF_CIF,
		.slot = slot,
		.port = port,
	};
	socklen_t addrlen = sizeof(remote);
	int ret, max_try = 10;

	ret = sendto(cif_sock, cfg, len, 0, (struct sockaddr *)&remote, sizeof(remote));

	if (ret < 0) {
		LOG_ERR("Failed to send data, errno %d", errno);
		return false;
	}

	while (--max_try) {
		int len = recvfrom(cif_sock, response, sizeof(response), 0,
				   (struct sockaddr *)&remote, (socklen_t *)(&addrlen));
		if (len > 0) {
			LOG_INF("Received cfg response %d bytes", len);
			LOG_HEXDUMP_INF(response, len, "Received data");
			/* FIXME: Need to read data back configuration to check if it is set ok */
			return true;
		} else if (len < 0 && errno == EAGAIN) {
			LOG_DBG("Wait for configuration done");
		} else if (len < 0) {
			LOG_ERR("Failed to receive data, errno %d", errno);
			return false;
		}
		LOG_DBG("No response, retry %d", max_try);
		/* Must make sure that give enough time for LDP to schedule other cycles */
		k_usleep(ASYNC_INTERVAL_TIME);
	}
	return false;
}

/* NOTE: this function is called in slave too. */
int handle_extra_errors(int sock)
{
	int ret;
	struct cif_error_filter err_mask = {
		.flags = 0,
	};
	socklen_t err_len = sizeof(err_mask);

	ret = getsockopt(sock, SOL_CIF_RAW, CIF_OPT_ERROR, &err_mask, &err_len);
	if (ret < 0 && errno != ENOENT) {
		LOG_WRN("Failed to get error mask, errno %d", errno);
	} else if (ret < 0 && errno == ENOENT) {
		/* No activated connection found */
		return 0;
	}

	ret = setsockopt(sock, SOL_CIF_RAW, CIF_OPT_ERROR, &err_mask, sizeof(err_mask));
	if (ret < 0) {
		LOG_WRN("Failed to clear error mask, errno %d", errno);
	}

	if (err_mask.error_mask) {
		if (err_mask.error_mask & (CIF_ERR_PREV_PREEMPT | CIF_ERR_PREEMPT)) {
			LOG_WRN("Preempt error detected, switch to slave mode");
			/* Close socket will release all resources */
			ctx_.target_role = role_slave;
			ctx_.target_opt = normal;
			ctx_.state = STATE_IDLE;
			zsock_close(sock);
			slave_start();
			return 1;
		} else if (err_mask.error_mask & (CIF_ERR_R_ERROR | CIF_ERR_I_ERROR)) {
			struct cif_info info;
			int rc;

			LOG_WRN("I_ERROR/R_ERROR detected");
			err_len = sizeof(info);
			rc = getsockopt(sock, SOL_CIF_RAW, CIF_OPT_INFO, &info, &err_len);
			if (rc < 0) {
				LOG_ERR("Failed to get CIF socket info, errno %d", errno);
			} else {
				LOG_INF("CIF socket info: i_err[0]: %d, i_err[1]: %d",
					info.i_err[0], info.i_err[1]);
			}
		} else if (err_mask.error_mask & CIF_ERR_MAY_LOST) {
			LOG_WRN_ONCE("MAY_LOST error detected");
		} else if (err_mask.error_mask & CIF_ERR_PREV_T_ERROR) {
			LOG_WRN_ONCE("PREV_T_ERROR detected");
		} else if (err_mask.error_mask & CIF_ERR_PREV_R_ERROR) {
			LOG_WRN_ONCE("PREV_R_ERROR detected");
		} else if (err_mask.error_mask & CIF_ERR_PREV_I_ERROR) {
			LOG_WRN_ONCE("PREV_I_ERROR detected");
		} else if (err_mask.error_mask & CIF_ERR_PREV_P_ERROR) {
			LOG_WRN_ONCE("PREV_P_ERROR detected");
		} else if (err_mask.error_mask & CIF_ERR_PREV_MAY_LOST) {
			LOG_WRN_ONCE("PREV_MAY_LOST detected");
		} else if (err_mask.error_mask & CIF_ERR_PREV_INVALID_ASYNC_PACK) {
			LOG_WRN_ONCE("PREV_INVALID_ASYNC_PACK detected");
		} else if (err_mask.error_mask & CIF_ERR_PREV_RX_DROP_NOMEM) {
			LOG_WRN_ONCE("PREV_RX_DROP_NOMEM detected");
		} else if (err_mask.error_mask & CIF_ERR_PREV_RX_DROP_FIFO_FULL) {
			LOG_WRN_ONCE("PREV_RX_DROP_FIFO_FULL detected");
		} else if (err_mask.error_mask & CIF_ERR_PREV_RX_DROP_DUPLICATE) {
			LOG_WRN_ONCE("PREV_RX_DROP_DUPLICATE detected");
		} else if (err_mask.error_mask & CIF_ERR_PREV_RX_DROP_INVALID) {
			LOG_WRN_ONCE("PREV_RX_DROP_INVALID detected");
		} else if (err_mask.error_mask & CIF_ERR_PREV_ATIMEOUT) {
			LOG_WRN_ONCE("PREV_ATIMEOUT detected");
		} else {
			LOG_ERR("Unknown error mask 0x%08x detected", err_mask.error_mask);
		}
	}
	return 0;
}

static bool handle_idle_state(void)
{
	if (!parse_cmd()) {
		/* Give up CPU and hand over */
		k_usleep(SYNC_CYCLE_TIME);
	}
	return true;
}

static bool handle_discover_state(int sock)
{
	bool res = dev_discovery(sock, ctx_.target_sid);

	LOG_INF("Slot %d %s", ctx_.target_sid, res ? "exist" : "not exist");
	ctx_.state = STATE_IDLE;
	return true;
}

static bool handle_config_state(int sock)
{
	uint32_t flags = CIF_PORT_FLG_STRONG_ORDER | CIF_PORT_FLG_ONE_SHOT;

	bool res = dev_general_init(sock, ctx_.target_sid, PORT_ID_CFG,
				    ctx_.target_opt == normal
					    ? flags
					    : flags | CIF_PORT_FLG_PREEMPT | CIF_PORT_FLG_SW_SLAVE,
				    ASYNC_DEFAULT_BANDWIDTH);

	if (res) {
		static const char config_data[] = "cfg:123";

		res = dev_general_cfg(sock, ctx_.target_sid, PORT_ID_CFG, config_data,
				      sizeof(config_data));
		LOG_INF("Slot %d configuration %s", ctx_.target_sid, res ? "done" : "not done");
		dev_general_deinit(sock, ctx_.target_sid, PORT_ID_CFG);
	}

	ctx_.state = STATE_IDLE;
	return true;
}

static bool handle_io_start_state(int sock, uint32_t *timeout, bool is_sw_slave)
{
	uint8_t flg_preempt = ctx_.target_opt == preempt ? CIF_PORT_FLG_PREEMPT : 0;
	uint8_t flg_sw_slave = is_sw_slave ? CIF_PORT_FLG_SW_SLAVE : 0;

	bool res = dev_general_init(sock, ctx_.target_sid, ctx_.target_port,
				    flg_preempt | flg_sw_slave, ctx_.target_pps);

	*timeout = k_uptime_get_32() + ctx_.target_duration;
	if (!res) {
		LOG_ERR("Failed to establish connection to slot%d", ctx_.target_sid);
		ctx_.state = STATE_IDLE;
		return false;
	}

	struct sockaddr_cif remote = {
		.cif_family = AF_CIF,
		.slot = ctx_.target_sid,
		.port = ctx_.target_port,
	};
	ctx_.curr.cif_family = remote.cif_family;
	ctx_.curr.slot = remote.slot;
	ctx_.curr.port = remote.port;
	ctx_.curr_len = sizeof(ctx_.curr);
	ctx_.stat_ok = 0;
	ctx_.stat_failed = 0;
	ctx_.systick_begin = k_uptime_get_32();

	int ret = sendto(sock, "io:0", 4, 0, (struct sockaddr *)&remote, sizeof(remote));

	if (ret < 0) {
		LOG_ERR("Failed to send data, errno %d", errno);
		ctx_.state = STATE_CLOSE;
		return false;
	}

	ctx_.state = STATE_IO;
	return true;
}

static bool handle_io_state(int sock, uint32_t *timeout, uint8_t *in_buf, size_t in_buf_size,
			    const uint8_t *out_buf, size_t out_buf_size)
{
	bool is_timeout = k_uptime_get_32() > *timeout;

	if (!is_timeout) {
		int ret;

		/* spin to avoid RX FIFO full */
		do {
			ret = recvfrom(sock, in_buf, in_buf_size, 0, (struct sockaddr *)&ctx_.curr,
				       &ctx_.curr_len);
			if (ret < 0 && errno != EAGAIN) {
				LOG_ERR("Failed to receive data, errno %d", errno);
				ctx_.stat_failed++;
			} else if (ret > 0) {
				LOG_HEXDUMP_DBG(in_buf, ret, "Received data from slot");
				ctx_.stat_ok++;
			}
		} while (ret > 0);

		ret = sendto(sock, out_buf, out_buf_size, 0, (struct sockaddr *)&ctx_.curr,
			     ctx_.curr_len);
		if (ret < 0 && errno != EAGAIN) {
			LOG_ERR("Failed to send data, errno %d", errno);
			ctx_.stat_failed++;
		}
	} else {
		ctx_.systick_end = k_uptime_get_32();
		bool res = dev_general_deinit(sock, ctx_.target_sid, ctx_.target_port);
		int32_t duration = ctx_.systick_end - ctx_.systick_begin;

		if (!res) {
			LOG_ERR("Failed to close port %d on slot %d", ctx_.target_port,
				ctx_.target_sid);
		}
		ctx_.state = STATE_IDLE;
		LOG_INF("IO tested, package passed: %d err: %d, percentage: %3d%%", ctx_.stat_ok,
			ctx_.stat_failed, ctx_.stat_ok * 100 / (ctx_.stat_ok + ctx_.stat_failed));
		LOG_INF("Duration: %dms", duration);
	}
	return true;
}
static void handle_open_ports_echo(int sock)
{
	static uint8_t buf[CIF_ASYNC_MTU];

	for (int i = 0; i < MAX_OPEN_PORTS; i++) {
		if (!open_ports[i].active) {
			continue;
		}

		struct sockaddr_cif port_addr = {
			.cif_family = AF_CIF,
			.slot = open_ports[i].sid,
			.port = open_ports[i].port,
		};
		socklen_t addr_len = sizeof(port_addr);
		bool need_echo = false;
		uint32_t now, later;
		uint32_t elapsed;
		int ret;

		now = k_cyc_to_us_near32(k_cycle_get_32());
		ret = recvfrom(sock, buf, sizeof(buf), 0, (struct sockaddr *)&port_addr, &addr_len);
		later = k_cyc_to_us_near32(k_cycle_get_32());
		if (ret > 0) {
			open_ports[i].stat_received++;
#if defined(CONFIG_CIF_ISSUE3_LATENCY_LOG)
			if (CIF_IS_ASYNC_PORT(open_ports[i].port) &&
			    open_ports[i].issue3_waiting_rx) {
				uint32_t delta_us;

				if (open_ports[i].issue3_last_tx_us > later) {
					delta_us = (uint32_t)((uint64_t)UINT32_MAX + later -
							      open_ports[i].issue3_last_tx_us);
				} else {
					delta_us = later - open_ports[i].issue3_last_tx_us;
				}

				LOG_INF("ISSUE3_LAT sid=%u port=%u delta_us=%u outcome=data",
					open_ports[i].sid, open_ports[i].port, delta_us);
				open_ports[i].issue3_waiting_rx = false;
			}
#endif
			LOG_DBG("Echoing data for port %d", open_ports[i].port);
			need_echo = true;
		} else if (errno != EAGAIN) {
			open_ports[i].stat_error++;
			if (open_ports[i].stat_error < MAX_OPEN_ERRORS) {
				LOG_ERR("Failed to receive data from [%d:%d], errno:%d",
					open_ports[i].sid, open_ports[i].port, errno);
			} else if (open_ports[i].stat_error == MAX_OPEN_ERRORS) {
				LOG_ERR("Too many errors, stop echoing for port %d",
					open_ports[i].port);
			}
		}
		if (now > later) {
			elapsed = (uint32_t)((uint64_t)UINT32_MAX + later - now);
		} else {
			elapsed = later - now;
		}
		open_ports[i].lag_rx_avg = (open_ports[i].lag_rx_avg * 7 + elapsed) / 8;
		if (elapsed > open_ports[i].lag_rx_max) {
			open_ports[i].lag_rx_max = elapsed;
		}

		if (need_echo || ctx_.perf_mode) {

			/* if perf is enabled, ret might be negative, reset to a default value */
			if (ret < 0) {
				ret = 0x20;
			}

			now = k_cyc_to_us_near32(k_cycle_get_32());
			ret = sendto(sock, buf, ret, 0, (struct sockaddr *)&port_addr, addr_len);
			later = k_cyc_to_us_near32(k_cycle_get_32());

			if (ret >= 0) {
				open_ports[i].stat_sent++;
#if defined(CONFIG_CIF_ISSUE3_LATENCY_LOG)
				if (CIF_IS_ASYNC_PORT(open_ports[i].port)) {
					open_ports[i].issue3_last_tx_us = later;
					open_ports[i].issue3_waiting_rx = true;
				}
#endif
			}
			if (ret < 0 && errno != EAGAIN) {
				LOG_ERR("Failed to echo data, errno %d", errno);
			} else {
				LOG_DBG("Echoed %d bytes to port %d", ret, open_ports[i].port);
			}

			if (now > later) {
				elapsed = (uint32_t)((uint64_t)UINT32_MAX + later - now);
			} else {
				elapsed = later - now;
			}
			open_ports[i].lag_tx_avg = (open_ports[i].lag_tx_avg * 7 + elapsed) / 8;
			if (elapsed > open_ports[i].lag_tx_max) {
				open_ports[i].lag_tx_max = elapsed;
			}
		}
	}
}

static bool handle_open_state(int sock, uint8_t *response_buf, size_t response_buf_size)
{
	/* Open port and initialize with data */
	bool res = dev_general_init(sock, ctx_.target_sid, ctx_.target_port,
				    ctx_.target_opt == preempt ? CIF_PORT_FLG_PREEMPT : 0,
				    ASYNC_DEFAULT_BANDWIDTH);
	int ret;

	if (!res) {
		LOG_ERR("Failed to open port %d on slot %d", ctx_.target_port, ctx_.target_sid);
		ctx_.state = STATE_IDLE;
		return false;
	}

	struct sockaddr_cif remote = {
		.cif_family = AF_CIF,
		.slot = ctx_.target_sid,
		.port = ctx_.target_port,
	};

	if (ctx_.initial_data_len) {
		/* Send initial data */
		ret = sendto(sock, ctx_.initial_data, ctx_.initial_data_len, 0,
			     (struct sockaddr *)&remote, sizeof(remote));

		if (ret < 0) {
			LOG_ERR("Failed to send initial data, errno %d", errno);
			ctx_.state = STATE_IDLE;
			return false;
		}
	}

	LOG_INF("Port %d on slot %d opened successfully with initial data", ctx_.target_port,
		ctx_.target_sid);

	/* Register the opened port */
	bool no_space = true;

	for (int i = 0; i < MAX_OPEN_PORTS; i++) {
		if (!open_ports[i].active) {
			memset(&open_ports[i], 0, sizeof(open_ports[i]));
			open_ports[i].sid = ctx_.target_sid;
			open_ports[i].port = ctx_.target_port;
			open_ports[i].active = true;
			open_ports[i].open_timestamp = k_uptime_get_32();
#if defined(CONFIG_CIF_ISSUE3_LATENCY_LOG)
			open_ports[i].issue3_last_tx_us = k_cyc_to_us_near32(k_cycle_get_32());
			open_ports[i].issue3_waiting_rx =
				ctx_.initial_data_len > 0 && CIF_IS_ASYNC_PORT(ctx_.target_port);
#endif
			LOG_INF("Port %d registered as open", ctx_.target_port);
			no_space = false;
			break;
		}
	}

	if (no_space) {
		LOG_ERR("No space to register port %d", ctx_.target_port);
		ctx_.state = STATE_IDLE;
		dev_general_deinit(sock, ctx_.target_sid, ctx_.target_port);
		return false;
	}

	ctx_.state = STATE_IDLE;
	return true;
}

static bool handle_close_state(int sock)
{
	/* Close the port */
	bool res = dev_general_deinit(sock, ctx_.target_sid, ctx_.target_port);

	if (res) {
		LOG_INF("Port %d on slot %d closed successfully", ctx_.target_port,
			ctx_.target_sid);
	} else {
		LOG_ERR("Failed to close port %d on slot %d", ctx_.target_port, ctx_.target_sid);
	}

	/* Unregister the closed port */
	for (int i = 0; i < MAX_OPEN_PORTS; i++) {
		if (open_ports[i].active && open_ports[i].port == ctx_.target_port) {
			open_ports[i].active = false;
			LOG_INF("Port %d unregistered as closed", ctx_.target_port);
			break;
		}
	}

	ctx_.state = STATE_IDLE;
	return true;
}

static void handle_io_buf(uint8_t *in_buf, uint8_t *out_buf, size_t *out_buf_len)
{
	if (CIF_IS_ASYNC_PORT(ctx_.target_port)) {
		out_buf[0] = 'a';
		out_buf[1] = 's';
		out_buf[2] = 'y';
		out_buf[3] = 'n';
		out_buf[4] = 'c';
		out_buf[5] = ':';
		out_buf[6]++;
		*out_buf_len = ctx_.initial_data_len;
	} else {
		out_buf[0] = 's';
		out_buf[1] = 'y';
		out_buf[2] = 'n';
		out_buf[3] = 'c';
		out_buf[4] = ':';
		out_buf[5]++;
		*out_buf_len = ctx_.initial_data_len;
	}
}

static bool handle_stats_state(int sock)
{
	LOG_INF("Getting port statistics:");

	for (int i = 0; i < MAX_OPEN_PORTS; i++) {
		if (!open_ports[i].active) {
			continue;
		}

		struct cif_stats stats = {.slot = open_ports[i].sid, .port = open_ports[i].port};
		socklen_t stats_len = sizeof(stats);

		int ret = getsockopt(sock, SOL_CIF_RAW, CIF_OPT_STATS, &stats, &stats_len);

		if (ret < 0) {
			LOG_ERR("Failed to get stats for SID: %d, Port: %d, errno: %d",
				open_ports[i].sid, open_ports[i].port, errno);
			continue;
		}

		LOG_INF("Port Statistics - SID: %d, Port: %d, mask=0x%08x", open_ports[i].sid,
			open_ports[i].port, stats.valid_mask);

		if (CIF_IS_STAT_VALID(&stats, CIF_STAT_ID_BLOCKING_TX_BYTES)) {
			LOG_INF("  Blocking TX bytes: %u",
				stats.val[CIF_STAT_ID_BLOCKING_TX_BYTES]);
		}

		if (CIF_IS_STAT_VALID(&stats, CIF_STAT_ID_BLOCKING_RX_BYTES)) {
			LOG_INF("  Blocking RX bytes: %u",
				stats.val[CIF_STAT_ID_BLOCKING_RX_BYTES]);
		}

		if (CIF_IS_STAT_VALID(&stats, CIF_STAT_ID_BLOCKING_TX_COUNT)) {
			LOG_INF("  Blocking TX count: %u",
				stats.val[CIF_STAT_ID_BLOCKING_TX_COUNT]);
		}

		if (CIF_IS_STAT_VALID(&stats, CIF_STAT_ID_BLOCKING_RX_COUNT)) {
			LOG_INF("  Blocking RX count: %u",
				stats.val[CIF_STAT_ID_BLOCKING_RX_COUNT]);
		}

		if (CIF_IS_STAT_VALID(&stats, CIF_STAT_ID_HIST_XFER_COUNT)) {
			LOG_INF("  Historical TX count: %u",
				stats.val[CIF_STAT_ID_HIST_XFER_COUNT]);
		}

		if (CIF_IS_STAT_VALID(&stats, CIF_STAT_ID_HIST_RX_COUNT)) {
			LOG_INF("  Historical RX count: %u", stats.val[CIF_STAT_ID_HIST_RX_COUNT]);
		}

		if (CIF_IS_STAT_VALID(&stats, CIF_STAT_ID_HIST_RX_COUNT_WITH_DATA)) {
			LOG_INF("  Historical RX count with data: %u",
				stats.val[CIF_STAT_ID_HIST_RX_COUNT_WITH_DATA]);
		}
		if (CIF_IS_STAT_VALID(&stats, CIF_STAT_ID_HIST_RX_COUNT_WITH_ACK)) {
			LOG_INF("  Historical RX count with ack: %u",
				stats.val[CIF_STAT_ID_HIST_RX_COUNT_WITH_ACK]);
		}

		LOG_INF("-----------------------");
	}

	ctx_.state = STATE_IDLE;
	return true;
}

static int main_master(void)
{
	LOG_INF("Running in master mode");

	/* Step 1: create a CIF socket */
	int sock = socket(AF_CIF, SOCK_RAW, CIF_RAW_MASTER);
	if (sock < 0) {
		LOG_ERR("Failed to create CIF socket, errno %d", errno);
		return -1;
	}

	/* Step 2: bind the CIF socket */
	struct sockaddr_cif local = {
		.cif_family = AF_CIF,
		.bus = ctx_.target_bus == bus_low ? CIF_BUS_SLOW : CIF_BUS_FAST,
		.slot = -1, /* not used */
		.port = -1, /* not used */
	};

	int ret = bind(sock, (struct sockaddr *)&local, sizeof(local));
	if (ret < 0) {
		LOG_ERR("Failed to bind CIF socket, errno %d", errno);
		close(sock);
		return -1;
	}

	/* Step 3: set the CIF socket options */
	const struct cif_raw_master_config config = {
		.poll_time = MCB_POLL_TIME,
		.cycle_time = SYNC_CYCLE_TIME,
		.sync_timeout = SYNC_TIMEOUT_TIME,
		.dr = CIF_DR_MPU_P,
		.dt = CIF_DT_MPU_P,
	};
	ret = setsockopt(sock, SOL_CIF_RAW, CIF_OPT_MASTER_CONFIG, &config, sizeof(config));
	if (ret < 0) {
		LOG_ERR("Failed to set CIF socket options, errno %d", errno);
		close(sock);
		return -1;
	}

	/* Step 4: Detect the device information */
	struct cif_info info;
	socklen_t cif_info_len = sizeof(info);

	ret = getsockopt(sock, SOL_CIF_RAW, CIF_OPT_INFO, &info, &cif_info_len);
	if (ret < 0) {
		LOG_ERR("Failed to get CIF socket info, errno %d", errno);
		close(sock);
		return -1;
	}
	LOG_INF("CIF socket info: slot %d, hw version: %d", info.slot, info.hw_version);
	LOG_INF("CIF socket info: i_err[0]: %d, i_err[1]: %d", info.i_err[0], info.i_err[1]);

	ctx_.state = STATE_IDLE;

	static uint8_t in_buf[CIF_MTU];
	static uint8_t out_buf[CIF_MTU];
	static uint8_t response_buf[2000];
	size_t out_buf_len;
	uint32_t timeout = 0;

	while (1) {
		/* Terminate condition */
		if (k_sem_take(&ctx_.terminate_sem, K_NO_WAIT) == 0) {
			zsock_close(sock);
			break;
		}

		switch (ctx_.state) {
		case STATE_IDLE:
			handle_idle_state();
			break;

		case STATE_DISCOVER:
			handle_discover_state(sock);
			break;

		case STATE_CONFIG:
			handle_config_state(sock);
			break;

		case STATE_IO_START:
			handle_io_start_state(sock, &timeout, false);
			break;

		case STATE_IO:
			handle_io_buf(in_buf, out_buf, &out_buf_len);
			handle_io_state(sock, &timeout, in_buf, sizeof(in_buf), out_buf,
					out_buf_len);

			/* If the port is sync, wait for the next cycle,
			 * otherwise, no more sleeping to improve performance.
			 */
			if (CIF_IS_SYNC_PORT(ctx_.target_port)) {
				k_usleep(SYNC_CYCLE_TIME);
			}
			break;

		case STATE_OPEN:
			handle_open_state(sock, response_buf, sizeof(response_buf));
			break;

		case STATE_CLOSE:
			handle_close_state(sock);
			break;

		case STATE_STATS:
			handle_stats_state(sock);
			break;
		}

		/* Handle periodic echo for open ports */
		handle_open_ports_echo(sock);

		if (handle_extra_errors(sock)) {
			break;
		}
	}

	return 0;
}

static struct k_thread master_thread;
static K_THREAD_STACK_DEFINE(master_stack, 4096);

int master_start(void)
{
	memset(&open_ports, 0, sizeof(open_ports));
	k_sem_init(&ctx_.terminate_sem, 0, 1);
	k_tid_t tid = k_thread_create(
		&master_thread, master_stack, K_THREAD_STACK_SIZEOF(master_stack),
		(k_thread_entry_t)main_master, NULL, NULL, NULL, K_PRIO_PREEMPT(10), 0, K_NO_WAIT);

	k_thread_name_set(&master_thread, "master");

	if (tid == NULL) {
		LOG_ERR("Failed to create master thread");
		return -1;
	}

	return 0;
}

int master_cancel(void)
{
	k_sem_give(&ctx_.terminate_sem);
	k_thread_join(&master_thread, K_FOREVER);
	return 0;
}
```
