## CMakeLists.txt
```
# SPDX-License-Identifier: Apache-2.0

cmake_minimum_required(VERSION 3.20.0)

find_package(Zephyr REQUIRED HINTS $ENV{ZEPHYR_BASE})
project(eth_diag_sample)

target_sources(app PRIVATE src/main.c)
```

## prj.conf
```kconfig
# Generic networking options
CONFIG_NETWORKING=y
CONFIG_NET_LOG=y
CONFIG_LOG=y
CONFIG_NET_IPV4=y
CONFIG_NET_IPV6=n

# Network buffer configuration
CONFIG_NET_PKT_RX_COUNT=64
CONFIG_NET_PKT_TX_COUNT=64
CONFIG_NET_BUF_RX_COUNT=800
CONFIG_NET_BUF_TX_COUNT=800
CONFIG_NET_BUF_DATA_SIZE=1536

# Ethernet configuration
CONFIG_NET_L2_ETHERNET=y
CONFIG_NET_L2_ETHERNET_MGMT=y

CONFIG_NET_SHELL=y

# Thread stack configuration
CONFIG_MAIN_STACK_SIZE=2048
CONFIG_SYSTEM_WORKQUEUE_STACK_SIZE=2048

# Log configuration
CONFIG_LOG_BUFFER_SIZE=4096
CONFIG_LOG_MODE_DEFERRED=y


# Network socket configuration
CONFIG_NET_SOCKETS=y
CONFIG_NET_SOCKETS_POSIX_NAMES=y


# Enable network statistics
CONFIG_NET_STATISTICS=y
CONFIG_NET_STATISTICS_ETHERNET=y
```

## boards/rbs2530_cpu_old.conf
```kconfig
# Network buffers
CONFIG_NET_PKT_RX_COUNT=64
CONFIG_NET_PKT_TX_COUNT=64
CONFIG_NET_BUF_RX_COUNT=800
CONFIG_NET_BUF_TX_COUNT=800

CONFIG_SYSTEM_WORKQUEUE_STACK_SIZE=8192
CONFIG_SYSTEM_WORKQUEUE_PRIORITY=2
CONFIG_NUM_PREEMPT_PRIORITIES=16

CONFIG_MAIN_STACK_SIZE=8192
CONFIG_SYSTEM_WORKQUEUE_STACK_SIZE=8192
CONFIG_NET_SOCKETS_SERVICE_STACK_SIZE=2048

CONFIG_ETH_FMQL=y
CONFIG_MDIO=y
CONFIG_SERIAL_INIT_PRIORITY=50
CONFIG_ETH_INIT_PRIORITY=80
# CONFIG_NO_OPTIMIZATIONS=y
# CONFIG_DEBUG_OPTIMIZATIONS=y
CONFIG_NOCACHE_MEMORY=y

CONFIG_LOG=y
CONFIG_LOG_MODE_IMMEDIATE=y
CONFIG_LOG_BACKEND_SHOW_COLOR=n
CONFIG_LOG_MODE_DEFERRED=y
CONFIG_LOG_BUFFER_SIZE=8192
CONFIG_NET_LOG=y


CONFIG_NET_L2_ETHERNET=y
CONFIG_NET_L2_ETHERNET_MGMT=y

CONFIG_NET_ICMPV4_ACCEPT_BROADCAST=y

CONFIG_NET_ZPERF=y
CONFIG_NET_SOCKETS_SERVICE=y
CONFIG_NET_SOCKETS_SERVICE_THREAD_PRIO=40

CONFIG_NET_SOCKETS=y
CONFIG_NET_SOCKETS_POSIX_NAMES=y
CONFIG_NET_SOCKETS_POLL_MAX=128

CONFIG_NET_TCP_MAX_RECV_WINDOW_SIZE=65535
CONFIG_NET_TCP_MAX_SEND_WINDOW_SIZE=65535
CONFIG_NET_ZPERF_MAX_PACKET_SIZE=2048
CONFIG_NET_BUF_DATA_SIZE=1536
```

## boards/rbs2530_ec.overlay
```dts
&ethernet0 {
	status = "okay";
};
```

## src/main.c
```c
/*
 * Copyright (c) 2025 SYSTech Co.
 *
 * SPDX-License-Identifier: Apache-2.0
 */
#include <zephyr/kernel.h>
#include <zephyr/net/net_if.h>
#include <zephyr/net/ethernet.h>
#include <zephyr/net/net_core.h>
#include <zephyr/logging/log.h>

LOG_MODULE_REGISTER(eth_diag_sample, LOG_LEVEL_INF);

/* Define thread stack size */
#define STACK_SIZE 2048

/* Check interval (milliseconds) */
#define CHECK_INTERVAL 2000

/* Main thread stack */
K_THREAD_STACK_DEFINE(thread_stack, STACK_SIZE);
static struct k_thread thread_data;

/**
 * @brief Get physical link status
 *
 * @param iface Network interface pointer
 * @return true Link is connected
 * @return false Link is disconnected
 */
static bool get_phy_link_status(struct net_if *iface)
{
	const struct device *dev = net_if_get_device(iface);
	const struct ethernet_api *api = dev->api;
	struct ethernet_config config = {0};
	bool link_up = false;

	/* Check if driver supports getting configuration */
	if (api && api->get_config) {
		/* Get link status */
		if (api->get_config(dev, ETHERNET_CONFIG_TYPE_LINK, &config) == 0) {
			/* Any speed link connection indicates the link is up */
			link_up = config.l.link_10bt || config.l.link_100bt || config.l.link_1000bt;
		}
	}

	return link_up;
}

/**
 * @brief Check receive error count
 *
 * @param iface Network interface pointer
 * @return int Error count or -1 if unavailable
 */
static int check_rx_errors(struct net_if *iface)
{
#if defined(CONFIG_NET_STATISTICS_ETHERNET)
	const struct device *dev = net_if_get_device(iface);
	const struct ethernet_api *api = dev->api;

	if (api && api->get_stats) {
		struct net_stats_eth *stats = api->get_stats(dev);

		if (stats) {
			/* Get receive error count */
			return stats->error_details.rx_crc_errors;
		}
	}
#endif /* CONFIG_NET_STATISTICS_ETHERNET */

	return -1;
}

/**
 * @brief Print interface diagnostic information
 *
 * @param iface Network interface pointer
 * @param idx Interface index
 */
static void print_interface_status(struct net_if *iface, int idx)
{
	bool link_status = get_phy_link_status(iface);
	int rx_errors = check_rx_errors(iface);

	LOG_INF("Interface %d: %s | Error count: %d", idx,
		link_status ? "Connected" : "Disconnected", rx_errors);
}

/**
 * @brief Diagnostic thread function
 */
static void diagnostic_thread(void *p1, void *p2, void *p3)
{
	ARG_UNUSED(p1);
	ARG_UNUSED(p2);
	ARG_UNUSED(p3);

	/* Wait for network interface initialization */
	k_sleep(K_SECONDS(1));

	LOG_INF("Ethernet diagnostic started...");
	LOG_INF("------------------------------------");

	while (1) {
		int if_count = 0;

		/* Sleep for specified interval before checking */
		k_sleep(K_MSEC(CHECK_INTERVAL));

		/* Iterate through all ethernet interfaces */
		STRUCT_SECTION_FOREACH(net_if, iface) {
			/* Print interface status */
			print_interface_status(iface, if_count++);
		}

		if (if_count > 0) {
			LOG_INF("------------------------------------");
		} else {
			LOG_INF("No ethernet interfaces found");
		}
	}
}

int main(void)
{
	LOG_INF("Ethernet Diagnostic Report Sample Started");
	LOG_INF("Checking link status and RX error count every %d ms\n\n", CHECK_INTERVAL);

	/* Create diagnostic thread */
	k_thread_create(&thread_data, thread_stack, STACK_SIZE, diagnostic_thread, NULL, NULL, NULL,
			K_LOWEST_APPLICATION_THREAD_PRIO, 0, K_NO_WAIT);
	k_thread_name_set(&thread_data, "eth_diag");

	return 0;
}
```
