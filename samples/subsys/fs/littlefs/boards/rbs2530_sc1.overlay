/**
 * Copyright (c) 2024 SYSFly Co.
 * SPDX-License-Identifier: Apache-2.0
 */

#include <common/mem.h>

&mmc0 {
	status = "okay";
	non-removable;

	usr {
		compatible = "zephyr,mmc-disk";
		status = "okay";
		bus-width = <4>;
	};
};
