## CMakeLists.txt
```
# SPDX-License-Identifier: Apache-2.0

cmake_minimum_required(VERSION 3.20.0)

find_package(Zephyr REQUIRED HINTS $ENV{ZEPHYR_BASE})
project(gmssl_sm3)

target_sources(app PRIVATE src/main.c)
```

## sample.yaml
```
sample:
  description: minimal sample, the SM3 testcase
  name: gmssl_sm3
common:
  tags: footprint
  harness: console
  harness_config:
    type: one_line
    regex:
      - "Basic SM3 test"
tests:
  sample.module.gmssl.gmssl_sm3.qemu_cortex_m3:
    build_only: true
    platform_allow:
      - qemu_cortex_m3
```

## prj.conf
```kconfig
# GmSSL minimal configuration for SM3 support only
CONFIG_GMSSL=y

# Disable problematic modules
CONFIG_GMSSL_SDF=n
CONFIG_GMSSL_TLS=n

# Keep only essential cryptographic functions
# SM3 is included by default when GMSSL is enabled

# Disable additional algorithms to reduce footprint
CONFIG_GMSSL_SHA1=n
CONFIG_GMSSL_SHA2=n
CONFIG_GMSSL_AES=n
CONFIG_GMSSL_CHACHA20=n

# Disable SM4 modes to reduce footprint
CONFIG_GMSSL_SM4_ECB=n
CONFIG_GMSSL_SM4_OFB=n
CONFIG_GMSSL_SM4_CFB=n
CONFIG_GMSSL_SM4_CCM=n
CONFIG_GMSSL_SM4_XTS=n
CONFIG_GMSSL_SM4_CBC_MAC=n

# Disable extensions
CONFIG_GMSSL_SM2_EXTS=n
CONFIG_GMSSL_SM3_XMSS=n
```

## src/main.c
```c
/*
 * Copyright (c) 2019 Nordic Semiconductor ASA
 *
 * SPDX-License-Identifier: Apache-2.0
 */

#include <zephyr/kernel.h>
#include <string.h>

#include <gmssl/sm3.h>
#include <gmssl/hex.h>

static int hex_compare(const char *expected, const uint8_t *data, size_t len)
{
	char hex_output[2 * len + 1];

	hex_output[2 * len] = '\0';

	for (size_t i = 0; i < len; i++) {
		sprintf(&hex_output[2 * i], "%02x", data[i]);
	}

	if (strcmp(expected, hex_output) == 0) {
		printk("Hex comparison successful: %s\n", hex_output);
	} else {
		printk("Hex comparison failed: expected %s, got %s\n", expected, hex_output);
		return -1;
	}

	return 0;
}

int main(void)
{
	printk("Hello World from minimal!\n");

	/* Test SM3 hash function */
	SM3_CTX ctx;
	uint8_t hash[SM3_DIGEST_SIZE];
	const char *test_data = "abc";

	printk("Testing GmSSL SM3 hash function...\n");

	sm3_init(&ctx);
	sm3_update(&ctx, (uint8_t *)test_data, strlen(test_data));
	sm3_finish(&ctx, hash);

	printk("SM3 hash of '%s': ", test_data);
	for (int i = 0; i < SM3_DIGEST_SIZE; i++) {
		printk("%02x", hash[i]);
	}
	printk("\n");

	/* Expected hash for "abc": 66c7f0f462eeedd9d1f2d46bdc10e4e24167c4875cf2f7a2297da02b8f4ba8e0
	 */
	static const char expected_hash[] =
		"66c7f0f462eeedd9d1f2d46bdc10e4e24167c4875cf2f7a2297da02b8f4ba8e0";

	if (!hex_compare(expected_hash, hash, SM3_DIGEST_SIZE)) {
		printk("SM3 hash test passed!\n");
	} else {
		printk("SM3 hash test failed!\n");
		return -1;
	}

	return 0;
}
```
