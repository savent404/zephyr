## CMakeLists.txt
```
#
# Copyright (c) 2018 Nordic Semiconductor
#
# SPDX-License-Identifier: LicenseRef-BSD-5-Clause-Nordic
#

cmake_minimum_required(VERSION 3.13.1)

find_package(Zephyr REQUIRED HINTS $ENV{ZEPHYR_BASE})
project(i2c_scanner)

target_sources(app PRIVATE src/main.c)
```

## Kconfig
```
#
# Copyright (c) 2024 SYSTech Co.
#
# SPDX-License-Identifier: Apache-2.0
#

menu "I2C Scanner settings"
config I2C_SCAN_ADDR_START
	int "First address to start scanning I2C devices."
	default 8

config I2C_SCAN_ADDR_STOP
	int "Last address for scanning I2C devices."
	default 127
endmenu

module = I2CScanner
module-str = I2C Scanner Demo Application
source "${ZEPHYR_BASE}/subsys/logging/Kconfig.template.log_config"

menu "Zephyr Kernel"
source "Kconfig.zephyr"
endmenu
```

## prj.conf
```kconfig
#
# Copyright (c) 2019 Nordic Semiconductor ASA
#
# SPDX-License-Identifier: LicenseRef-BSD-5-Clause-Nordic
#
# General config
CONFIG_NEWLIB_LIBC=y

#I2C
CONFIG_I2C=y
CONFIG_I2C_DW=y

# enable console
CONFIG_CONSOLE=y
CONFIG_UART_CONSOLE=y

# Enable RTT
#CONFIG_USE_SEGGER_RTT=n
#CONFIG_RTT_CONSOLE=n

# Stacks and heaps
CONFIG_MAIN_STACK_SIZE=2048
CONFIG_HEAP_MEM_POOL_SIZE=8192

# Application Specific settings
CONFIG_I2C_SCAN_ADDR_START=8
CONFIG_I2C_SCAN_ADDR_STOP=127
```

## rbs2530_cpu.overlay
```dts
/ {
	aliases {
		my-i2c = &i2c0;
	};
};

&i2c0 {
	status = "okay";
	pinctrl-0 = <&i2c0_pins_mio_50>, <&i2c0_pins_mio_51>;
	pinctrl-names = "default";
};
```

## src/main.c
```c
/**
 * Copyright (c) 2024 SYSTech Co.
 * SPDX-License-Identifier: Apache-2.0
 */

#include <zephyr/kernel.h>
#include <zephyr/sys/printk.h>
#include <zephyr/drivers/i2c.h>
#include <zephyr/device.h>

#define I2C_NODE DT_ALIAS(my_i2c)

int main(void)
{
	const struct device *i2c_dev;

	k_sleep(K_SECONDS(1));
	printk("*** I2C scanner started.                    ***\nBoard name      : %s\n",
	       CONFIG_BOARD);

	i2c_dev = DEVICE_DT_GET(I2C_NODE);
	if (!device_is_ready(i2c_dev)) {
		printk("I2C: Device driver not found.\n");
		return -1;
	}

	printk("I2C Port        : %s\n", i2c_dev->name);
	printk("Clock Frequency : %d\n", DT_PROP(I2C_NODE, clock_frequency));

	printk("I2C Address    : 0x%02x - 0x%02x\n", CONFIG_I2C_SCAN_ADDR_START,
	       CONFIG_I2C_SCAN_ADDR_STOP);
	printk("\n    | 0x00 0x01 0x02 0x03 0x04 0x05 0x06 0x07 0x08 0x09 0x0a 0x0b 0x0c 0x0d 0x0e "
	       "0x0f |\n");
	printk("----|------------------------------------------------------------------------------"
	       "------|\n");

	uint8_t error = 0u;
	uint8_t dst;
	uint8_t i2c_dev_cnt = 0;
	struct i2c_msg msgs[1];

	msgs[0].buf = &dst;
	msgs[0].len = 1U;
	msgs[0].flags = I2C_MSG_WRITE | I2C_MSG_STOP;

	/* Use the full range of I2C address for display purpose */
	for (uint16_t x = 0; x <= 0x7f; x++) {
		/* New line every 0x10 address */
		if (x % 0x10 == 0) {
			printk("|\n0x%02x| ", x);
		}
		/* Range the test with the start and stop value configured in the kconfig */
		if (x >= CONFIG_I2C_SCAN_ADDR_START && x <= CONFIG_I2C_SCAN_ADDR_STOP) {
			/* Send the address to read from */
			error = i2c_transfer(i2c_dev, &msgs[0], 1, x);
			/* I2C device found on current address */
			if (error == 0) {
				printk("0x%02x ", x);
				i2c_dev_cnt++;
			} else {
				printk(" --  ");
			}
		} else {
			/* Scan value out of range, not scanned */
			printk("     ");
		}
	}
	printk("|\n");
	printk("\nI2C device(s) found on the bus: %d\nScanning done.\n\n", i2c_dev_cnt);

	return 0;
}
```
