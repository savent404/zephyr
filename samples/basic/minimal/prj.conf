## CMakeLists.txt
```
# SPDX-License-Identifier: Apache-2.0

cmake_minimum_required(VERSION 3.20.0)

find_package(Zephyr REQUIRED HINTS $ENV{ZEPHYR_BASE})
project(minimal)

target_sources(app PRIVATE src/main.cpp src/ad7124-8.cpp)
target_include_directories(app PRIVATE inc)
```

## prj.conf
```kconfig
# empty config
CONFIG_SHELL=n
CONFIG_SPI=y
CONFIG_SPI_SHELL=n
```

## prj_mini.conf
```kconfig
# empty config

# ARM options
# Reason: NMI handler is an optional feature that is not used by safety-critical applications.
CONFIG_RUNTIME_NMI=n
CONFIG_FP16=n

# Interrupt configuration (No debug/exception handling)
CONFIG_GEN_ISR_TABLES=n
CONFIG_EXCEPTION_DEBUG=n

# Cache options
CONFIG_DCACHE=n
CONFIG_ICACHE=n

# Kernel options
CONFIG_ERRNO=n
CONFIG_CURRENT_THREAD_USE_TLS=n
CONFIG_BOOT_BANNER=n
CONFIG_TIMESLICING=n # WARN: disables preemption, this may affect some subsystems (e.g. networking)
CONFIG_KERNEL_MEM_POOL=n
CONFIG_TICKLESS_KERNEL=n # NOTE: tickless is more efficient but also increases handling logic complexity (+400 code size)

# Drivers (optional, without this, there will be no any outputs on serial port)
CONFIG_CONSOLE=n
CONFIG_SERIAL=n
CONFIG_PINCTRL_FMQL=n
CONFIG_CLOCK_CONTROL_FMSH=n

# Virtual memory support
CONFIG_MMU=n
CONFIG_ARM_AARCH32_MMU=n

# libc options
CONFIG_MINIMAL_LIBC=y
CONFIG_COMMON_LIBC_MALLOC=n
CONFIG_MINIMAL_LIBC_TIME=n

# utilities
CONFIG_CBPRINTF_N_SPECIFIER=n
CONFIG_CBPRINTF_NANO=n

# debug options
CONFIG_STACK_SENTINEL=n
CONFIG_ASSERT_VERBOSE=n
CONFIG_NO_RUNTIME_CHECKS=y
```

## prj_prod.conf
```kconfig
# kernel options
CONFIG_SCHED_SCALABLE=y # optimized for performance and scalability for 20+ threads
CONFIG_THREAD_RUNTIME_STATS_OVERFLOW_PROTECTION=y # fixup overflow issue in runtime stats
CONFIG_STATIC_INIT_GNU=y # make sure global static c++ objects are initialized

# debug options
CONFIG_ASSERT=y # enable assert for debugging
CONFIG_DEBUG_THREAD_INFO=y # improve debug experience by providing thread info for GDB
CONFIG_SYMTAB=y # application can access symbol table for self-diagnosis

# logging options (depends on CONFIG_LOG)
CONFIG_LOG_SPEED=y
CONFIG_LOG_PROCESS_THREAD_SLEEP_MS=100 # reduce log processing interval to improve responsiveness
CONFIG_LOG_THREAD_ID_PREFIX=y # include thread ID in log messages
CONFIG_LOG_INFO_COLOR_GREEN=y # use green color for info logs
CONFIG_LOG_DBG_COLOR_BLUE=y # use blue color for debug logs

# build options
CONFIG_BUILD_OUTPUT_COMPRESS_DEBUG_SECTIONS=y # compress debug sections to reduce binary size
CONFIG_MISRA_SANE=y # enable MISRA C compliance checks
CONFIG_FORTIFY_SOURCE_RUN_TIME=y # enable runtime checks for buffer overflows
CONFIG_COMPILER_WARNINGS_AS_ERRORS=y
CONFIG_DEBUG_OPTIMIZATIONS=y # Optimizing for size will reduce code size but may affect performance,
                             # and optimize for debug is a better choice than optimize for performance
```

## src/main.cpp
```c
/*
 * Copyright (c) 2019 Nordic Semiconductor ASA
 *
 * SPDX-License-Identifier: Apache-2.0
 */

#include <zephyr/kernel.h>
#include <zephyr/drivers/spi.h>

#include "ad7124-8.hpp"

#define SPI_ID DT_NODELABEL(spi1)
#define SPI_DEV DEVICE_DT_GET(SPI_ID)

struct spi_iface_zephyr: public spi_iface {
	explicit spi_iface_zephyr(const struct device *iface, struct spi_config *cfg, const struct gpio_dt_spec *cs_gpios) :
		iface_(iface),
		cfg_(cfg),
		cs_(cs_gpios)
	{
		gpio_pin_configure(iface_, cs_gpios->pin, GPIO_OUTPUT_INACTIVE);
	}
	virtual ~spi_iface_zephyr() {}

	bool xfer(uint8_t *tx, uint8_t *rx, uint8_t tx_size, uint8_t rx_size) override;

	const struct device*iface_;
	struct spi_config *cfg_;
	const struct gpio_dt_spec *cs_;
};

template <int depth>
void record(uint32_t v, int32_t *max, int32_t *min, int32_t *avg)
{
	static uint32_t rec[depth];
	static int idx = 0;
	static bool init = false;

	rec[idx] = v;

	if (idx == depth - 1) {
		init = true;
	}

	if (init) {
		int64_t max_v = 0;
		int64_t min_v = 0xFFFFFFFF;
		int64_t sum = 0;

		for (int i = 0; i < depth; i++) {
			if (rec[i] > max_v) {
				max_v = rec[i];
			}
			if (rec[i] < min_v) {
				min_v = rec[i];
			}
			sum += rec[i];
		}

		int32_t avg_v = sum / depth;

		if (max) {
			*max = (int32_t)(max_v - avg_v);
		}
		if (min) {
			*min = (int32_t)(min_v - avg_v);
		}
		if (avg) {
			*avg = (int32_t)(avg_v);
		}
	}
	idx = (idx + 1) % depth;
}

float fn_val(uint32_t val, uint8_t r, bool bipolar, double gain=1e3)
{
	double val_to_vol[] = {
		2.5 / (0x800000 - 1),
		1.25 / (0x800000 - 1),
		0.625 / (0x800000 - 1),
		0.3125 / (0x800000 - 1),
		0.15625 / (0x800000 - 1),
		0.078125 / (0x800000 - 1),
		0.0390625 / (0x800000 - 1),
		0.01953125 / (0x800000 - 1),
	};
	double val_to_vol_unipolar[] = {
		2.5 / (0x1000000 - 1),
		1.25 / (0x1000000 - 1),
		0.625 / (0x1000000 - 1),
		0.3125 / (0x1000000 - 1),
		0.15625 / (0x1000000 - 1),
		0.078125 / (0x1000000 - 1),
		0.0390625 / (0x1000000 - 1),
		0.01953125 / (0x1000000 - 1),
	};
	double v;
	
	if (bipolar) {
		v = ((int64_t)val - 0x800000) * val_to_vol[r];
	} else {
		v = val * val_to_vol_unipolar[r];
	}
	v *= gain;
	return (float)v;
}

int main(void)
{
	const struct device *dev_spi = SPI_DEV;
	struct spi_config config;
	struct spi_cs_control cs_ctrl = (struct spi_cs_control){
		.gpio = GPIO_DT_SPEC_GET(SPI_ID, cs_gpios),
		.delay = 0u,
	};

	config.frequency = 1000000;
	config.operation = SPI_OP_MODE_MASTER | SPI_WORD_SET(8) | SPI_MODE_CPOL | SPI_MODE_CPHA;
	config.slave = 0;
	config.cs = cs_ctrl;

	spi_iface_zephyr spi(dev_spi, &config, &cs_ctrl.gpio);

	adc7124_8::adc adc(&spi);

	k_msleep(100);

	if (adc.is_alive()) {
		printk("ADC7124 detected\n");
	} else {
		printk("ADC7124 not detected\n");
	}

	adc.initialize();

	auto range = adc7124_8::cha_ctrl_param::CHA_RANGE_2_5V;
	uint16_t fs_reject[] = { 48, 40, 384}; // 50Hz, 60Hz, 50Hz(FullPower)
	using namespace adc7124_8;

	adc_ctrl_param adc_ctrl = {
		.clk_ref = adc_ctrl_param::ADC_CLK_REF_INT,
		.mode = adc_ctrl_param::ADC_MODE_CONTINUE,
		.internal_vol_ref = true,
		.pwr_mode = adc_ctrl_param::ADC_PWR_MODE_FULL
	};

	adc.adc_config(adc_ctrl);
	adc.diag_config(static_cast<uint32_t>(adc_diag::DIAG_MASK));
	// adc.diag_config(static_cast<uint32_t>(0));
	cha_ctrl_param ctrl = {
		.range = range,
		.ref = cha_ctrl_param::CHA_REF_INTERNAL,
		.AIN_BUF_P = false,
		.AIN_BUF_N = false,
		.REF_BUF_P = false,
		.REF_BUF_N = false,
		.burnout = cha_ctrl_param::CHA_BURNOUT_OFF,
		.bipolar = true,
	};
	cha_filter_param filter = {
		.type = cha_filter_param::FILTER_TYPE_SINC3,
		.reject_50_60Hz = true,
		.post = cha_filter_param::post_filter_reserved,
		.single_cycle = false,
		.fs = fs_reject[2],
	};
	for (int i = 0; i < 8; i++) {
		if (i <= 1) {
			adc.cha_config(i, true ? true : false, ctrl, filter, adc_pin_mux::ADC_PIN_MUX_DIFF_AUTO);
		}
		else {
			adc.cha_config(i, false, ctrl, filter, adc_pin_mux::ADC_PIN_MUX_DIFF_AUTO);
		}
	}
	printk("ADC7124 initialized\n");

	int64_t convert_time = 0;
	int64_t convert_duration;
	bool wirebreak = false;
	while (1) {
		uint8_t status;
		uint32_t diag;
		uint8_t ch;
		uint32_t val;

		/* Check status */
		if (!adc.get_status(&status)) {
			printk("Error reading status\n");
			continue;
		}
		if (!adc.status_is_data_ready(status)) {
			continue;
		}
		ch = adc.status_get_curr_cha(status);
		convert_duration = k_uptime_ticks() - convert_time;

		/* check diagnostics */
		if (!adc.get_diag(&diag)) {
			printk("Error reading diag\n");
			continue;
		}

		/* Read data */
		if (adc.get_data(&val) != true) {
			printk("Error reading data: status %02X\n", status);
			continue;
		}

		/* spin till adc start to convert */
		int64_t tick = k_uptime_ticks();
		do {
			if (!adc.get_status(&status)) {
				printk("Error reading status\n");
				break;
			}
		} while (adc.status_is_data_ready(status));
		convert_time = k_uptime_ticks();
		tick = k_uptime_ticks() - tick;
		if (ch == 1) {
			int32_t max = 0, min = 0;
			record<128>(val, &max, &min, nullptr);
			printk("Channel %d: %6x(%8.4fmV)\t {%08.3fuV, %08.3fuV, %08.3fuV}\tdiag: %06X\tspin: %03lld us\tconvert: %03lld ms\n",
				ch, val, fn_val(val, range, ctrl.bipolar),
				fn_val(max, range, ctrl.bipolar, 1e6), fn_val(min, range, ctrl.bipolar, 1e6), fn_val(max-min, range, ctrl.bipolar, 1e6),
				diag, k_ticks_to_us_near64(tick), k_ticks_to_ms_near64(convert_duration));
		}
		// adc.cha_config(ch, false, ctrl, filter, adc_pin_mux::ADC_PIN_MUX_DIFF_AUTO);

		// if (wirebreak)
		// {
		// 	wirebreak = false;
		// 	ctrl.burnout = cha_ctrl_param::CHA_BURNOUT_OFF;
		// 	ctrl.range = range;
		// 	adc.cha_config(ch, true, ctrl, filter, adc_pin_mux::ADC_PIN_MUX_DIFF_AUTO);
		// }
		// else
		// {
		// 	wirebreak = true;
		// 	ctrl.burnout = cha_ctrl_param::CHA_BURNOUT_4uA;
		// 	ctrl.range = cha_ctrl_param::CHA_RANGE_312_5mV;
		// 	ch = (ch + 1) % 8;
		// 	adc.cha_config(ch, true, ctrl, filter, adc_pin_mux::ADC_PIN_MUX_DIFF_AUTO);
		// }
	}

	return 0;
}

bool spi_iface_zephyr::xfer(uint8_t *tx, uint8_t *rx, uint8_t tx_size, uint8_t rx_size)
{
	struct spi_buf tx_buf = {
		.buf = tx,
		.len = tx_size,
	};

	struct spi_buf rx_buf = {
		.buf = rx,
		.len = rx_size,
	};

	struct spi_buf_set tx_bufs = {
		.buffers = &tx_buf,
		.count = 1,
	};

	struct spi_buf_set rx_bufs = {
		.buffers = &rx_buf,
		.count = 1,
	};

	int ret = spi_transceive(iface_, cfg_, &tx_bufs, &rx_bufs);

	return !ret ? true : false;
}
```

## inc/ad7124-8.hpp
```c
#pragma once

#include <cstdint>
#include <cstddef>

#ifndef BIT
#define BIT(n) (1U << (n))
#endif

struct spi_iface {
	virtual ~spi_iface() = default;
	virtual bool xfer(uint8_t *tx, uint8_t *rx, uint8_t tx_size, uint8_t rx_size) = 0;
};

namespace adc7124_8
{
enum {
	REG_STATUS = 0x00,
	REG_ADC_CTRL = 0x01,
	REG_DATA = 0x02,
	REG_IO_CTRL_1 = 0x03,
	REG_IO_CTRL_2 = 0x04,
	REG_ID = 0x05,
	REG_ERR = 0x06,
	REG_ERR_EN = 0x07,
	REG_MCLK_CNT = 0x08,
	REG_CHA_0 = 0x09,
	REG_CHA_1 = 0x0A,
	REG_CHA_2 = 0x0B,
	REG_CHA_3 = 0x0C,
	REG_CHA_4 = 0x0D,
	REG_CHA_5 = 0x0E,
	REG_CHA_6 = 0x0F,
	REG_CHA_7 = 0x10,
	REG_CHA_8 = 0x11,
	REG_CHA_9 = 0x12,
	REG_CHA_10 = 0x13,
	REG_CHA_11 = 0x14,
	REG_CHA_12 = 0x15,
	REG_CHA_13 = 0x16,
	REG_CHA_14 = 0x17,
	REG_CHA_15 = 0x18,
	REG_CONFIG_0 = 0x19,
	REG_CONFIG_1 = 0x1A,
	REG_CONFIG_2 = 0x1B,
	REG_CONFIG_3 = 0x1C,
	REG_CONFIG_4 = 0x1D,
	REG_CONFIG_5 = 0x1E,
	REG_CONFIG_6 = 0x1F,
	REG_CONFIG_7 = 0x20,
	REG_FILTER_0 = 0x21,
	REG_FILTER_1 = 0x22,
	REG_FILTER_2 = 0x23,
	REG_FILTER_3 = 0x24,
	REG_FILTER_4 = 0x25,
	REG_FILTER_5 = 0x26,
	REG_FILTER_6 = 0x27,
	REG_FILTER_7 = 0x28,
	REG_OFFSET_0 = 0x29,
	REG_OFFSET_1 = 0x2A,
	REG_OFFSET_2 = 0x2B,
	REG_OFFSET_3 = 0x2C,
	REG_OFFSET_4 = 0x2D,
	REG_OFFSET_5 = 0x2E,
	REG_OFFSET_6 = 0x2F,
	REG_OFFSET_7 = 0x30,
	REG_GAIN_0 = 0x31,
	REG_GAIN_1 = 0x32,
	REG_GAIN_2 = 0x33,
	REG_GAIN_3 = 0x34,
	REG_GAIN_4 = 0x35,
	REG_GAIN_5 = 0x36,
	REG_GAIN_6 = 0x37,
	REG_GAIN_7 = 0x38,
};

enum class status : uint8_t {
	STATUS_RDY_N = BIT(7),
	STATUS_ERR = BIT(6),
	STATUS_POR = BIT(4),
};

enum class adc_pin_mux: uint8_t {
    ADC_PIN_MUX_DIFF_0 = 0, /* asign channel to use AI+0 and AI-1 */
    ADC_PIN_MUX_DIFF_1 = 1, /* asign channel to use AI+2 and AI-3 */
    ADC_PIN_MUX_DIFF_2 = 2, /* asign channel to use AI+4 and AI-5 */
    ADC_PIN_MUX_DIFF_3 = 3, /* asign channel to use AI+6 and AI-7 */
    ADC_PIN_MUX_DIFF_4 = 4, /* asign channel to use AI+8 and AI-9 */
    ADC_PIN_MUX_DIFF_5 = 5, /* asign channel to use AI+10 and AI-11 */
    ADC_PIN_MUX_DIFF_6 = 6, /* asign channel to use AI+12 and AI-13 */
    ADC_PIN_MUX_DIFF_7 = 7, /* asign channel to use AI+14 and AI-15 */
    ADC_PIN_MUX_DIFF_AUTO = 8, /* auto asign channel, AI+{ch*2} and AI-{ch*2+1} */
};

enum class adc_diag : uint32_t {
	DIAG_ROM_CRC = BIT(0),
	DIAG_MEM_CRC = BIT(1),
	DIAG_SPI_CRC = BIT(2),
	DIAG_SPI_WR = BIT(3),
	DIAG_SPI_RD = BIT(4),
	DIAG_SPI_SCK = BIT(5),
	DIAG_SPI_IGNORE = BIT(6),
	DIAG_ALDO_PSM = BIT(7),
	DIAG_ALDO_PSM_TRIP_TEST = BIT(8),
	DIAG_DLDO_PSM = BIT(9),
	DIAG_DLDO_PSM_TRIP_TEST = BIT(10),
	DIAG_REF_DET = BIT(11),
	DIAG_AINM_UV = BIT(12),
	DIAG_AINM_OV = BIT(13),
	DIAG_AINP_UV = BIT(14),
	DIAG_AINP_OV = BIT(15),
	DIAG_ADC_SAT = BIT(16),
	DIAG_ADC_CONV = BIT(17),
	DIAG_ADC_CAL = BIT(18),
	DIAG_LDO_CAP_CHK = BIT(19),
	DIAG_LDO_CAP_CHK_TRIP_TEST = BIT(20),
	DIAG_MCK_CNT = BIT(21),
	DIAG_MASK = 0x7F'FF'FF,
};

enum class REG_CHA: uint16_t {
	REG_CHA_EN = BIT(15),
};

struct adc_ctrl_param {
	enum {
		ADC_CLK_REF_INT = 0,
		ADC_CLK_REF_INT_OUT = 1, /* output internal clock at CLK pin */
		ADC_CLK_EXT = 2,
		ADC_CLK_EXT_DIV4 = 3,
	} clk_ref;
	enum {
		ADC_MODE_CONTINUE = 0,
		ADC_MODE_ONESHOT = 1,
		ADC_MODE_STANDBY = 2,
		ADC_MODE_PWR_DOWN = 3,
		ADC_MODE_IDLE = 4,
		ADC_MODE_INT_OFFSET_CALIBRATION = 5,
		ADC_MODE_INT_GAIN_CALIBRATION = 6,
		ADC_MODE_SYS_OFFSET_CALIBRATION = 7,
		ADC_MODE_SYS_GAIN_CALIBRATION = 8,
	} mode;
	bool internal_vol_ref;
	enum {
    	ADC_PWR_MODE_LOW = 0,
    	ADC_PWR_MODE_MID = 1,
    	ADC_PWR_MODE_FULL = 2,
	} pwr_mode;
};

struct cha_ctrl_param {
	enum {
		CHA_RANGE_2_5V = 0,
		CHA_RANGE_1_25V = 1,
		CHA_RANGE_625mV = 2,
		CHA_RANGE_312_5mV = 3,
		CHA_RANGE_156_25mV = 4,
		CHA_RANGE_78_125mV = 5,
		CHA_RANGE_39_0625mV = 6,
		CHA_RANGE_19_53125mV = 7,
	} range;
	enum {
		CHA_REF_1 = 0,
		CHA_REF_2 = 1,
		CHA_REF_INTERNAL = 2,
		CHA_REF_AVDD = 3, /* Analog VDD */
	} ref;
	bool AIN_BUF_P;
	bool AIN_BUF_N;
	bool REF_BUF_P;
	bool REF_BUF_N;
	enum {
		CHA_BURNOUT_OFF = 0,
		CHA_BURNOUT_0_5uA = 1,
		CHA_BURNOUT_2uA = 2,
		CHA_BURNOUT_4uA = 3,
	} burnout;
	bool bipolar;
};

struct cha_filter_param {
	enum {
    	FILTER_TYPE_SINC4 = 0, /* default */
    	FILTER_TYPE_SINC3 = 2,
    	FILTER_TYPE_SINC4_FAST = 4,
    	FILTER_TYPE_SINC3_FAST = 5,
    	FILTER_TYPE_POST_FILTER = 7,
	} type;
    bool reject_50_60Hz;
	enum {
    	post_filter_reserved = 0,
    	post_filter_47hz = 2,
    	post_filter_62hz = 3,
    	post_filter_86hz = 5,
    	post_filter_92hz = 6,
	} post;
    bool single_cycle; /* only works on single analog input channel and continue conversion mode */
    uint16_t fs; /* 10:0 */
};

struct cmd {
    explicit cmd(bool wen, bool read, int reg):
        cmd_(static_cast<uint8_t>(reg) | (wen ? 0 : BIT(7)) | (read ? BIT(6) : 0))
    {}
    uint8_t operator()() const { return cmd_; }
    uint8_t operator=(uint8_t cmd) { return cmd_; }
private:
    uint8_t cmd_;
};

struct adc {
    explicit adc(spi_iface *spi) : spi_(spi) {}

	bool initialize(void);
    bool is_alive(void);
	bool get_status(uint8_t *status);
    bool get_data(uint32_t *data);
    bool get_diag(uint32_t *diag);
	void adc_config(adc_ctrl_param ctrl);
    void cha_config(uint8_t ch, bool enable, const cha_ctrl_param ctrl, const cha_filter_param filter, adc_pin_mux mux);
    void diag_config(uint32_t diag_mask);

    bool status_is_data_ready(uint8_t status);
    uint8_t status_has_error(uint8_t status);
    uint8_t status_get_curr_cha(uint8_t status);
private:
	static inline uint8_t crc8_(uint8_t *data, uint8_t len) {
		uint8_t crc = 0;

		for (uint8_t i = 0; i < len; i++) {
			crc ^= data[i];
			for (int j = 0; j < 8; j++) {
				if (crc & 0x80) {
					crc = (crc << 1) ^ 0x07;
				} else {
					crc <<= 1;
				}
			}
		}
		return crc;
	}

    template <int bytes, typename T>
    bool r_(cmd c, T* ptr, bool check_crc)
    {
		uint8_t tx_bf[bytes + 2] = { c() };
		uint8_t rx_bf[bytes + 2]; /* cmd:data:crc */
		T v = 0;
		uint8_t crc_expected;
		uint8_t crc;

		if (!spi_->xfer(tx_bf, rx_bf, sizeof(tx_bf), sizeof(rx_bf))) {
			return false;
		}

		for (int i = 0; i < bytes; i++) {
			v |= rx_bf[i + 1] << (8 * (bytes - i - 1));
		}
		crc_expected = rx_bf[bytes + 1];

		/* crc including cmd and data */
		rx_bf[0] = c();
		crc = crc8_(&rx_bf[0], bytes + 1);

		if (check_crc && crc != crc_expected) {
			return false;
		}

		*ptr = v;
        return true;
    }

	template <int bytes, typename T>
	void w_(cmd c, T ptr, bool check_crc)
	{
		uint8_t tx_buf[bytes + 2] = { c() };
		uint8_t size = sizeof(tx_buf);
		uint8_t crc;

		for (int i = 0; i < bytes; i++) {
			tx_buf[i + 1] = (ptr >> (8 * (bytes -i - 1))) & 0xFF;
		}
		if (check_crc) {
			crc = crc8_(&tx_buf[0], bytes + 1);
			tx_buf[bytes + 1] = crc;
		} else {
			size--;
		}
		spi_->xfer(tx_buf, nullptr, size, 0);
	}

    spi_iface *spi_;
	bool crc_check_;
};


} // namespace adc7124_8
```

## src/ad7124-8.cpp
```c
#include "ad7124-8.hpp"
#include <zephyr/kernel.h>

using namespace adc7124_8;

bool adc::is_alive(void)
{
    uint8_t res = 0;

    /* This function will be called no matter crc_check_ is true or false */
    r_<1>(cmd{true, true, REG_ID}, &res, false);
    return res == 0x17;
}

bool adc::initialize(void)
{
    uint32_t reg_diag;

    /* read back some register to check if driver is out of track */
    r_<3>(cmd{true, true, REG_ERR_EN}, &reg_diag, false);
    if (reg_diag & static_cast<uint8_t>(adc_diag::DIAG_SPI_CRC)) {
        crc_check_ = true;
    } else {
        crc_check_ = false;
    }

    return true;
}

bool adc::get_status(uint8_t *status)
{
    return r_<1>(cmd{true, true, REG_STATUS}, status, false);
}

bool adc::status_is_data_ready(uint8_t status)
{
    return status & static_cast<uint8_t>(status::STATUS_RDY_N) ? false : true;
}

uint8_t adc::status_has_error(uint8_t status)
{
    const uint8_t err_mask = static_cast<uint8_t>(status::STATUS_ERR) | static_cast<uint8_t>(status::STATUS_POR);
    return status & err_mask;
}

uint8_t adc::status_get_curr_cha(uint8_t status)
{
    return status & 0x0F;
}

bool adc::get_data(uint32_t *data)
{
    return r_<3>(cmd{true, true, REG_DATA}, data, crc_check_);
}

bool adc::get_diag(uint32_t *diag)
{
    return r_<3>(cmd{true, true, REG_ERR}, diag, crc_check_);
}

void adc::adc_config(adc_ctrl_param param)
{
    uint16_t p = 0;
    p |= (static_cast<uint8_t>(param.clk_ref) << 0);
    p |= ((static_cast<uint8_t>(param.mode) & 0x7) << 2);
    p |= ((static_cast<uint8_t>(param.pwr_mode) & 0x3) << 6);
    p |= (param.internal_vol_ref ? 0 : BIT(8));
    w_<2>(cmd{true, false, REG_ADC_CTRL}, p, crc_check_);
}

void adc::cha_config(uint8_t ch, bool enable, const cha_ctrl_param ctrl, const cha_filter_param filter, adc_pin_mux mux)
{

    cmd c{true, false, REG_CHA_0 + ch};
    uint16_t p = 0;

    if (ch > 8) {
        return;
    }
    if (enable) {
        p |= static_cast<uint16_t>(REG_CHA::REG_CHA_EN);
    }
    p |= (ch << 12); /* use different setup as default */
    if (mux == adc_pin_mux::ADC_PIN_MUX_DIFF_AUTO) {
        p |= (ch*2 << 5);
        p |= (ch*2 + 1);
    } else {
        uint8_t _c = static_cast<uint8_t>(mux) & 0x7;
        p |= (_c << 5);
        p |= (_c + 1);
    }
    w_<2>(cmd{true, false, REG_CHA_0 + ch}, p, crc_check_);

    cmd cfg{true, false, REG_CONFIG_0 + ch};
    uint16_t cfg_val = 0;
    cfg_val |= (ctrl.bipolar ? BIT(11) : 0);
    cfg_val |= (static_cast<uint8_t>(ctrl.burnout) & 0x3) << 9;
    cfg_val |= (ctrl.REF_BUF_P ? BIT(8) : 0);
    cfg_val |= (ctrl.REF_BUF_N ? BIT(7) : 0);
    cfg_val |= (ctrl.AIN_BUF_P ? BIT(6) : 0);
    cfg_val |= (ctrl.AIN_BUF_N ? BIT(5) : 0);
    cfg_val |= (static_cast<uint8_t>(ctrl.ref) & 0x3) << 3;
    cfg_val |= (static_cast<uint8_t>(ctrl.range) & 0x7);
    w_<2>(cfg, cfg_val, crc_check_);

    cmd f{true, false, REG_FILTER_0 + ch};
    uint32_t f_val = 0;
    f_val |= filter.fs & 0x3FF; /* output data rate */
    f_val |= (filter.single_cycle ? BIT(16) : 0);
    f_val |= (static_cast<uint8_t>(filter.post) & 0x7) << 17;
    f_val |= (filter.reject_50_60Hz ? BIT(20) : 0);
    f_val |= (static_cast<uint8_t>(filter.type) & 0x7) << 21;
    w_<3>(f, f_val, crc_check_);
}

void adc::diag_config(uint32_t diag_mask)
{
    w_<3>(cmd{true, false, REG_ERR_EN}, diag_mask & 0x7F'FF'FF, crc_check_);

    if (diag_mask & static_cast<uint32_t>(adc_diag::DIAG_SPI_CRC)) {
        crc_check_ = true;
        printk("CRC check enabled\n");
    } else {
        crc_check_ = false;
        printk("CRC check disabled\n");
    }
}
```
