/*
 * Copyright (c) 2024 SYSTech Co.
 * SPDX-License-Identifier: Apache-2.0
 */

/dts-v1/;

#include <fmsh/rbs2530.dtsi>


&ethernet0 {
	pinctrl-0 = <&mdio0_clk_mio_52>, <&mdio0_data_mio_53>;
	pinctrl-names = "default";
	mdio-addr = <1>;
	gmii2rgmii-addr1 = <0x8>;
	gmii2rgmii-addr2 = <0x9>;
	phy-mode = "fiber";  /* fiber or utp */
	phy-delay = <0x2000>;
	local-ip-address = "192.168.10.12";
	local-netmask = "255.255.255.0";
	local-gateway = "192.168.10.1";
	local-mac-address = [ 8C 1F 64 5A E1 A2  ];
	status = "okay";
};

&ethernet1 {
	pinctrl-0 = <&mdio0_clk_mio_52>, <&mdio0_data_mio_53>;
	pinctrl-names = "default";
	mdio-addr = <3>;
	gmii2rgmii-addr1 = <0x8>;
	gmii2rgmii-addr2 = <0x9>;
	phy-mode = "fiber";  /* fiber or utp */
	phy-delay = <0x2000>;
	local-ip-address = "192.168.11.12";
	local-netmask = "255.255.255.0";
	local-gateway = "192.168.11.1";
	local-mac-address = [ 8C 1F 64 5A E1 B2  ];
	status = "okay";
};
