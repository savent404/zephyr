## dts/bindings/syscon/netforward,sf2507.yaml
```yaml
# Copyright (c) 2025 SYSFly Co.
# SPDX-License-Identifier: Apache-2.0

description: SF2507 Registers R/W

compatible: "netforward,sf2507"

include: [spi-device.yaml]

properties:
  spi-max-frequency:
    type: int
    default: 200000
    description: The maximum SPI frequency in Hz. Default is 200kHz.
  register-init:
    type: array
    description: |
      Array of register address and value pairs for initialization.
      Format is <address value address value...>
  reset_delay:
    type: int
    default: 100
    description: |
      Delay in milliseconds after reset. Default is 1000ms.
  gpios:
    type: phandle-array
    description: |
      Array of GPIOs to be used as reset pins. The first pin in the array
      will be used for the reset pin, and the second pin will be used for
      the power down pin. If only one pin is provided, it will be used as
      the reset pin.
```

## samples/basic/button_irq/sample.yaml
```yaml
sample:
  name: Button(IRQ) Sample
tests:
  sample.basic.button_irq:
    tags:
      - button
      - gpio
    filter: dt_enabled_alias_with_parent_compat("sw0", "gpio-keys")
    integration_platforms:
      - rbs2530_cpu
    depends_on: gpio
    harness: button
```

## samples/net/sockets/echo_client/boards/rbs2530_cpu_old.conf
```kconfig
# Network buffers
CONFIG_NET_PKT_RX_COUNT=64
CONFIG_NET_PKT_TX_COUNT=64
CONFIG_NET_BUF_RX_COUNT=800
CONFIG_NET_BUF_TX_COUNT=800

CONFIG_SYSTEM_WORKQUEUE_STACK_SIZE=8192
CONFIG_SYSTEM_WORKQUEUE_PRIORITY=2
CONFIG_NUM_PREEMPT_PRIORITIES=16

CONFIG_NET_CONFIG_MY_IPV4_ADDR="192.168.10.10"
CONFIG_NET_CONFIG_PEER_IPV4_ADDR="192.168.10.1"
CONFIG_MAIN_STACK_SIZE=8192
CONFIG_SYSTEM_WORKQUEUE_STACK_SIZE=8192
CONFIG_NET_SOCKETS_SERVICE_STACK_SIZE=2048

CONFIG_ETH_FMQL=y
CONFIG_MDIO=y
CONFIG_SERIAL_INIT_PRIORITY=50
CONFIG_ETH_INIT_PRIORITY=80
# CONFIG_NO_OPTIMIZATIONS=y
# CONFIG_DEBUG_OPTIMIZATIONS=y
CONFIG_NOCACHE_MEMORY=y

CONFIG_LOG=y
CONFIG_LOG_MODE_IMMEDIATE=y
CONFIG_LOG_BACKEND_SHOW_COLOR=n
CONFIG_LOG_MODE_DEFERRED=y
CONFIG_LOG_BUFFER_SIZE=8192
CONFIG_NET_LOG=y

# CONFIG_NET_SOCKETS_LOG_LEVEL_DBG=y
# CONFIG_NET_CONN_LOG_LEVEL_DBG=y
# CONFIG_NET_CONTEXT_LOG_LEVEL_DBG=y
# CONFIG_NET_TCP_LOG_LEVEL_DBG=y
# CONFIG_NET_IF_LOG_LEVEL_DBG=y
# CONFIG_NET_L2_ETHERNET_LOG_LEVEL_DBG=y

# CONFIG_ETHERNET_LOG_LEVEL_DBG=y

# CONFIG_NET_PKT_LOG_LEVEL_DBG=y
# CONFIG_NET_BUF_LOG=y
# CONFIG_NET_BUF_LOG_LEVEL_DBG=y

CONFIG_NET_L2_ETHERNET=y
CONFIG_NET_L2_ETHERNET_MGMT=y
# CONFIG_HEAP_MEM_POOL_SIZE=65536

CONFIG_NET_ICMPV4_ACCEPT_BROADCAST=y

CONFIG_NET_ZPERF=y
CONFIG_NET_SOCKETS_SERVICE=y
CONFIG_NET_SOCKETS_SERVICE_THREAD_PRIO=40

CONFIG_NET_SOCKETS=y
CONFIG_NET_SOCKETS_POSIX_NAMES=y
CONFIG_NET_SOCKETS_POLL_MAX=128

CONFIG_NET_TCP_MAX_RECV_WINDOW_SIZE=65535
CONFIG_NET_TCP_MAX_SEND_WINDOW_SIZE=65535
CONFIG_NET_ZPERF_MAX_PACKET_SIZE=2048
CONFIG_NET_BUF_DATA_SIZE=1536

CONFIG_NET_IPV6=n
```

## samples/subsys/fs/littlefs/boards/eval_fmql20.conf
```kconfig
# Application configuration
CONFIG_APP_LITTLEFS_STORAGE_BLK_SDMMC=y

# SDMMC configuration
CONFIG_GPIO=y
CONFIG_SDHC=y
CONFIG_SDMMC_STACK=y

# Disk driver configuration
CONFIG_DISK_DRIVERS=y
CONFIG_DISK_ACCESS=y
CONFIG_DISK_DRIVER_SDMMC=y

# Littlefs configuration
CONFIG_FS_LITTLEFS_BLK_DEV=y
CONFIG_FS_LITTLEFS_CACHE_SIZE=512
```

## samples/subsys/fs/littlefs/boards/rbs2530_cpu.conf
```kconfig
#
# Copyright (c) 2024 SYSTech Co.
# SPDX-License-Identifier: Apache-2.0
#

# For QSPI driver
CONFIG_FLASH=y
CONFIG_FLASH_CAD_FLASH_QSPI_NOR=y

CONFIG_APP_LITTLEFS_STORAGE_FLASH=y
CONFIG_APP_WIPE_STORAGE=n
```

## samples/subsys/fs/littlefs/boards/rbs2530_cpu_old.conf
```kconfig
#
# Copyright (c) 2024 SYSTech Co.
# SPDX-License-Identifier: Apache-2.0
#

CONFIG_APP_WIPE_STORAGE=n

# eMMC driver
CONFIG_SDHC=y
CONFIG_MMC_STACK=y

# littlefs for eMMC
CONFIG_DISK_ACCESS=y
CONFIG_DISK_DRIVER_MMC=y
CONFIG_FS_LITTLEFS_BLK_DEV=y
CONFIG_FS_LITTLEFS_HEAP_PER_ALLOC_OVERHEAD_SIZE=128

# app for eMMC
CONFIG_APP_LITTLEFS_STORAGE_BLK_SDMMC=y
```

## soc/fmsh/fmql/Kconfig
```kconfig
#
# Copyright (c) 2021 Weidmueller Interface GmbH & Co. KG
# Copyright (c) 2024 SYSTech Co.
# SPDX-License-Identifier: Apache-2.0
#

if SOC_FAMILY_FMSH_FMQL

rsource "*/Kconfig"

endif # SOC_FAMILY_FMSH_FMQL
```
