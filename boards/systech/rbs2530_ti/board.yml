## boards/systech/rbs2530_ti/rbs2530_ti_defconfig
```kconfig
#
# Copyright (c) 2024 SYSTech Co.
#
# SPDX-License-Identifier: Apache-2.0
#
CONFIG_SYS_CLOCK_HW_CYCLES_PER_SEC=15000000
CONFIG_ARM_ARCH_TIMER=y

CONFIG_CONSOLE=y
CONFIG_RAM_CONSOLE=y
CONFIG_RAM_CONSOLE_BUFFER_SIZE=4096
```

## drivers/clock_control/Kconfig.fmsh
```kconfig
# FMSH

# Copyright (c) 2024 SYSTech Co.
# SPDX-License-Identifier: Apache-2.0

config CLOCK_CONTROL_FMSH
	bool "FMSH clock control driver"
	default y
	depends on SYSCON && DT_HAS_FMSH_PSOC_CLKC_ENABLED
	help
	  Enable support for FMSH clock driver.

config CLOCK_CONTROL_FMSH_DEBUG
	bool "FMSH clock control debug message (via printk)"
	default n
	depends on CLOCK_CONTROL_FMSH
	help
	  Extra debug message for FMSH clock driver.
```

## drivers/ethernet/Kconfig.rbs2530_cpu
```kconfig
# Copyright (c) 2024 SYSTech Co.
# SPDX-License-Identifier: Apache-2.0
menuconfig ETH_FMQL
	bool "FMQL Ethernet driver"
	depends on NET_L2_ETHERNET

if ETH_FMQL
	config ETH_FMQL_RX_BUFFER_SIZE
		int "Size of RX buffer"
		default 1524

	config ETH_FMQL_TX_BUFFER_SIZE
		int "Size of TX buffer"
		default 1524

	config ETH_FMQL_USE_RMII
		bool "Use RMII interface"
		default y

	config ETH_FMQL_RX_THREAD_PRIORITY
		int "RX thread priority"
		default 1
		help
		  Cooperative priority level for the RX thread.
		  This value is passed to K_PRIO_COOP() at build time.
		  Valid range is 0 .. (CONFIG_NUM_COOP_PRIORITIES - 1).
		  Lower values indicate higher priority. Default is 1.

	config ETH_FMQL_PHY_UPDATE_THREAD_PRIORITY
		int "PHY update thread priority"
		default NUM_PREEMPT_PRIORITIES
		help
		  Thread priority for the PHY link state update thread.
		  This value is used as an application thread priority and will be clamped
		  at runtime using CLAMP(value, 0, K_LOWEST_APPLICATION_THREAD_PRIO).
		  Lower values indicate higher priority.
		  Default is NUM_PREEMPT_PRIORITIES which will clamp to the lowest
		  available preemptive application priority.
endif
```

## drivers/i2c/Kconfig.dw
```kconfig
# Copyright (c) 2018 Intel Corporation
# SPDX-License-Identifier: Apache-2.0

menuconfig I2C_DW
	bool "Design Ware I2C support"
	default y
	depends on DT_HAS_SNPS_DESIGNWARE_I2C_ENABLED
	help
	  Enable the Design Ware I2C driver

config I2C_DW_CLOCK_SPEED
	int "Set the clock speed for I2C"
	depends on I2C_DW
	default 32

config I2C_DW_POLLING
	bool "Use polling for I2C transfers"
	depends on I2C_DW
	help
	  This option enables the use of polling for I2C transfers. If this
	  option is not selected, interrupts will be used.

config I2C_DW_LPSS_DMA
	bool "Use I2C integrated DMA for asynchronous transfer"
	depends on I2C_DW
	select DMA
	select DMA_INTEL_LPSS
	help
	  This option enables I2C DMA feature to be used for asynchronous
	  data transfers. All Tx operations are done using dma channel 0 and
	  all Rx operations are done using dma channel 1.

config I2C_DW_DMA
	bool "Use DMA for I2C transfers"
	depends on I2C_DW
	select DMA
	help
	  This option enables DMA support for I2C transfers. DMA will be used
	  for both TX and RX operations when available and data size exceeds
	  the configured threshold.

config I2C_DW_DMA_THRESHOLD
	int "DMA transfer threshold in bytes"
	depends on I2C_DW_DMA
	default 1
	help
	  Minimum number of bytes required to use DMA for I2C transfers.
	  Transfers smaller than this threshold will use interrupt mode.

config I2C_DW_DMA_TIMEOUT_MS
	int "DMA transfer timeout in milliseconds"
	depends on I2C_DW_DMA
	default 1000
	help
	  Timeout for DMA transfers in milliseconds.

config I2C_DW_RW_TIMEOUT_MS
	int "Set the Read/Write timeout in milliseconds"
	depends on I2C_DW
	default 100
```

## drivers/mcb/Kconfig
```kconfig
# MCB configuration options
# Copyright (c) 2025 SYSTech Co.
# SPDX-License-Identifier: Apache-2.0

menuconfig MCB
		bool "MCB: Low-level backplane driver"
		default n
		help
			Enable MCB Driver Configuration

if MCB

source "drivers/mcb/Kconfig.systech"

config MCB_INIT_PRIORITY
		int "Init priority"
		default 60
		help
			MCB device driver initialization priority.

module = MCB
module-str = mcb
source "subsys/logging/Kconfig.template.log_config"

endif # MCB
```

## drivers/mcb/Kconfig.systech
```kconfig
# Copyright (c) 2025 SYSTech Co.
# SPDX-License-Identifier: Apache-2.0

config MCB_SYSTECH
		bool "Systech MCB driver"
		default y
		depends on DT_HAS_SYSTECH_MCB_ENABLED
		help
			Enable Systech MCB driver.

config MCB_SYSTECH_BUFFER_MAX_LENGTH
		int "length of tx&rx buffer"
		default 2048
		depends on MCB_SYSTECH
		help
			Limit of the max buffer length.

config MCB_SYSTECH_HW_WORKAROUND
		bool "HW temporary solution"
		default y
		depends on MCB_SYSTECH
		help
			This is for HW workaround solutions

config MCB_SYSTECH_PANIC_ON_HW_ERROR
		bool "Panic on unexpected MCB hardware errors"
		default n
		depends on MCB_SYSTECH
		help
			Call k_panic() when the driver detects unexpected MCB hardware
			behavior. This option is intended for hardware diagnostics and
			must not be enabled in production builds.

config MCB_SYSTECH_TX_CTRL1_VERIFY
		bool "Verify CTRL1 register after TX trigger"
		default n
		depends on MCB_SYSTECH
		help
			Enable readback verification of the CTRL1 register after
			triggering TX. This is intended for debugging register write
			mismatch issues.

config MCB_SYSTECH_BUFFER_ALIGN
		int "tx&rx buffer align size"
		default 1
		depends on MCB_SYSTECH
		help
			This is for HW design limitation, once 8-bit write
			is supported, you can change it to 1.
```

## drivers/pinctrl/Kconfig.fmql
```kconfig
# Copyright 2024 (C) SYSTech Co.
# SPDX-License-Identifier: Apache-2.0
#

config PINCTRL_FMQL
	bool "Pin controller driver for FMQL SoCs"
	depends on DT_HAS_FMSH_FMQL_PINCTRL_ENABLED
	default y
	help
	  Enable pin controller driver for SYSTech FMQL series SoCs
```

## drivers/sdhc/Kconfig.dw
```kconfig
# Copyright (c) 2024 SYSTech Co.
# SPDX-License-Identifier: Apache-2.0

config SDHC_DW
	bool "DW MSHC Driver"
	default y
	select SDHC_SUPPORTS_NATIVE_MODE
	depends on DT_HAS_SNPS_DW_MSHC_ENABLED
	help
	  Enable the snps,dw-mshc driver.

config SDHC_DW_DMA
	bool "DW using DMA"
	default n
	depends on SDHC_DW
	help
	  Enable DMA support for snps,dw-mshc.

config SDHC_BUFFER_ALIGNMENT
	default 4
```

## drivers/syscon/Kconfig
```kconfig
# SYSCON configuration options

# Copyright (c) 2021 Carlo Caione <ccaione@baylibre.com>
# SPDX-License-Identifier: Apache-2.0

#
# SYSCON options
#
menuconfig SYSCON
	bool "System Controller (SYSCON) drivers"
	help
	  SYSCON (System Controller) drivers. System controller node represents
	  a register region containing a set of miscellaneous registers. The
	  registers are not cohesive enough to represent as any specific type
	  of device. The typical use-case is for some other node's driver, or
	  platform-specific code, to acquire a reference to the syscon node and
	  extract information from there.

if SYSCON

module = SYSCON
module-str = syscon
source "subsys/logging/Kconfig.template.log_config"

config SYSCON_GENERIC
	bool "Generic SYSCON (System Controller) driver"
	default y
	depends on DT_HAS_SYSCON_ENABLED
	help
	  Enable generic SYSCON (System Controller) driver

config SYSCON_SF2507
	bool "Switch driver (SF2507)"
	select SPI
	select GPIO
	select SPI_DW_LOW_SPEED_WORKAROUND if SPI_DW
	select SPI_DW_FMQL_EMIO_CS if SPI_DW
	default y
	depends on DT_HAS_NETFORWARD_SF2507_ENABLED
	help
	  Enable SF2507 driver

config SYSCON_INIT_PRIORITY
	int "SYSCON (System Controller) driver init priority"
	default 50
	help
	  This option controls the priority of the syscon device
	  initialization. Higher priority ensures that the device is
	  initialized earlier in the startup cycle. If unsure, leave at default
	  value

endif # SYSCON
```

## dts/bindings/clock/fmsh,psoc-clkc.yaml
```yaml
# Copyright (c) 2024 SYSTech Co.
# SPDX-License-Identifier: Apache-2.0

include: [base.yaml, clock-controller.yaml]

description: |
  FMSH Clock Manager clock output binding

compatible: "fmsh,psoc-clkc"

properties:
  reg:
    type: array
    description: Base address and lengths of the register space

  ps-clk-frequency:
    required: true
    type: int
    description: |
      default frequency in Hz for clock input
clock-cells:
  - clkid
```

## dts/bindings/ethernet/snps,fmsh-gmac.yaml
```yaml
description: FMQL GMAC Ethernet controller

compatible: "snps,fmsh-gmac"

include: [ethernet-controller.yaml, pinctrl-device.yaml]

properties:
  reg:
    required: true

  interrupts:
    required: true

  local-mac-address:
    type: uint8-array
    required: true
    description: "MAC address"

  clock-frequency:
    type: int
    required: true

  phy-handle:
    type: phandle
    required: true

  mdio-addr:
    type: int
    required: true
    description: "PHY MDIO address"

  gmii2rgmii-addr1:
    type: int
    required: true
    description: "GMII2RGMII converter 1 MDIO address"

  gmii2rgmii-addr2:
    type: int
    required: true
    description: "GMII2RGMII converter 2 MDIO address"

  phy-mode:
    type: string
    required: true
    enum:
      - "fiber"
      - "utp"
      - "none"
    description: "PHY interface mode selection"

  phy-delay:
    type: int
    required: true
    description: "PHY delay configuration value (hex)"

  fixed-speed:
    type: int
    default: 2
    enum:
      - 0
      - 1
      - 2
    description: "Link speed selection: 0=10Mbps, 1=100Mbps, 2=1000Mbps"

  auto-negotiation:
    type: int
    default: 1
    enum:
      - 0
      - 1
    description: "Enable auto-negotiation, defaults to true if not specified"

  local-ip-address:
    type: string
    required: true
    description: "Static IP address"

  local-netmask:
    type: string
    required: true
    description: "Network mask"

  local-gateway:
    type: string
    required: true
    description: "Gateway address"

  partner-mdio-addr:
    type: int
    description: "Partner PHY MDIO address"

  partner-phy-mode:
    type: string
    enum:
      - "fiber"
      - "utp"
      - "none"
    description: "Partner PHY interface mode selection"

  partner-phy-delay:
    type: int
    description: "Partner PHY delay configuration value (hex)"

  ext-phy-init-seq:
    type: array
    description: |
      MDIO initialization command stream encoded as 3-cell tuples:
        <phy_addr reg_addr value>

      Command forms:
        - Write: <phy_addr reg_addr value>
        - Read:  <phy_addr reg_addr 0xffffffff>
        - Delay: <0xff 0xee delay_us>

      Read uses 0xffffffff as a sentinel; the driver performs an MDIO read of reg_addr.
      Delay waits for delay_us microseconds.

      Examples:
        <0x02 0x00 0xffffffff>
        <0xff 0xee 0x64>
```

## dts/bindings/flash_controller/cdns,qspi-nor.yaml
```yaml
# Copyright (c) 2022 Intel Corporation
# SPDX-License-Identifier: Apache-2.0

description: Cadence Quad-SPI NOR flash controller

compatible: "cdns,qspi-nor"

include: [flash-controller.yaml, pinctrl-device.yaml]

properties:
  clock-frequency:
    type: int
    required: true
    description: clock frequency information for Cadence QSPI NOR Flash

  cpol:
    type: int
    default: 1
    description: Clock polarity (0 or 1)

  cpha:
    type: int
    default: 1
    description: Clock phase (0 or 1)

  sram-fifo-size:
    type: int
    default: 1024
    description: SRAM FIFO size in bytes

  flat-page-size:
    type: int
    default: 256
    description: Flat page size in bytes

  flat-page-count:
    type: int
    default: 32768
    description: Flat page count
```

## dts/bindings/mcb/systech,mcb.yaml
```yaml
# Copyright (c) 2025 SYSTech Co.
# SPDX-License-Identifier: Apache-2.0

description: SYSTech MCB Driver node

compatible: "systech,mcb"

include: base.yaml

properties:
  poll:
    type: int
    description: |
      The duration in microseconds between each poll of the MCB device.
    default: 100
  pps:
    type: int
    description: |
      The number of packets per second that the MCB device can handle.
    default: 1000
  slow:
    type: int
    description: |
      If true(>0), the MCB device is in slow mode.
    default: 0
```

## dts/bindings/mmc/snps,dw-mshc.yaml
```yaml
description: dw mshc driver

compatible: "snps,dw-mshc"

include: [mmc.yaml, pinctrl-device.yaml, reset-device.yaml]

properties:
  clocks:
    required: true

  reg:
    required: true

  data-addr:
    type: int
    required: true

  fifo-depth:
    type: int
    default: 16

  card-detect-delay:
    type: int
    default: 200

  non-removable:
    type: boolean
    description: |
      Non-removable slots (like eMMC), which are assumed to always be present,
      will affect the `sdhc_card_present` call. This call will always return
      true if this property exists for the node.

  bus-width:
    type: int
    default: 1
    description: |
      Bus width for SDMMC access, defaults to the minimum necessary
      number of bus lines. This parameter is controlled by MMC/SD stack.
    enum:
      - 1
      - 4
      - 8
```

## dts/bindings/pinctrl/fmsh,fmql-pinctl.yaml
```yaml
# Copyright (C) 2024 SYSTech Co.
# SPDX-License-Identifier: Apache-2.0
#

description: |
  FMQL Pin controller Node
  Based on pincfg-node.yaml binding.

compatible: "fmsh,fmql-pinctrl"

include: base.yaml

properties:
  reg:
    required: true
  syscon:
    type: phandle
    required: true
    description: |
      phandle to the syscon node that controls the pin configuration
      for the pinmux and drive-strength settings

child-binding:
  description: |
    Base binding configuration for FMQLxxx APUs
    Please use io_type to disable the pin

  include:
    - name: pincfg-node.yaml
      property-allowlist:
        - bias-high-impedance
        - bias-pull-down
        - bias-pull-up
        - input-disable
  properties:
    pinmux:
      required: true
      type: int
      description: |
        Integer array, represents gpio pin number and mux setting.
        These defines are calculated as: (port<<24 | pin<<16 | mux<<1)
        With:
        - pin: The pin offset within the port (0, 1, 2, ...)
        - mux: The function number, can be:
          * PINMUX_GPIO
          * PINMUX_QSPI
          * PINMUX_USB
          * PINMUX_NOR
          * PINMUX_NAND
          * PINMUX_SDIO_PWR
          * PINMUX_SDIO
          * PINMUX_CAN
          * PINMUX_I2C
          * PINMUX_SPI
          * PINMUX_TTC
          * PINMUX_UART
        In case selected pin function is GPIO, pin is statically configured as
        a plain input/output GPIO. Default configuration is input. Output value
        can be configured by adding 'ouptut-low' or 'output-high' properties
        to the pin configuration.

        To simplify the usage, macro is available to generate "pinmux" field.
        This macro is available here:
          -include/zephyr/dt-bindings/pinctrl/fmql-pinctrl.h
        Some examples of macro usage:
          {
            pinmux = <FMQL_PINMUX(MIO, 10, PINMUX_UART)>;
          };
    drive-strength:
      default: 8
      type: int
      enum: [4, 8, 12, 16]
      description: |
        Maximum sink or source current in mA
    io_type:
      default: 3
      type: int
      enum: [0, 1, 2, 3, 4, 5]
      description: |
        IO type
        0: disable
        1: LVCMOS 1.8V
        2: LVCMOS 2.5V
        3: LVCMOS 3.3V
        4: HSTL-I
        5: HSTL-II
    keeper:
      default: 0
      type: int
      enum: [0, 1]
      description: |
        Keeper, only valid for with pull-up or pull-down disabled
        0: disable
        1: enable
    hystr:
      default: 1
      type: int
      enum: [0, 1]
      description: |
        Hysteresis
        0: disable
        1: enable
```
