/*
 * Copyright (c) 2024 SYSFly Co.
 * SPDX-License-Identifier: Apache-2.0
 */

/dts-v1/;

#include <fmsh/rbs2530.dtsi>


&ethernet0 {
	pinctrl-0 = <&mdio0_clk_mio_52>, <&mdio0_data_mio_53>;
	pinctrl-names = "default";
	mdio-addr = <2>;
	gmii2rgmii-addr1 = <0x8>;
	gmii2rgmii-addr2 = <0x9>;
	phy-mode = "fiber";  /* fiber or utp */
	phy-delay = <0x30f6>;
	partner-mdio-addr = <1>;
	partner-phy-mode = "fiber";
	partner-phy-delay = <0x10f8>;
	local-ip-address = "192.168.10.16";
	local-netmask = "255.255.255.0";
	local-gateway = "192.168.10.1";
	local-mac-address = [ 8C 1F 64 5A E1 A6  ];
	status = "okay";
};

&ethernet1 {
	pinctrl-0 = <&mdio0_clk_mio_52>, <&mdio0_data_mio_53>;
	pinctrl-names = "default";
	mdio-addr = <1>;
	gmii2rgmii-addr1 = <0x8>;
	gmii2rgmii-addr2 = <0x9>;
	phy-mode = "fiber";  /* fiber or utp */
	phy-delay = <0x10f8>;
	local-ip-address = "192.168.11.16";
	local-netmask = "255.255.255.0";
	local-gateway = "192.168.11.1";
	local-mac-address = [ 8C 1F 64 5A E1 B6  ];
	status = "disabled";
};
