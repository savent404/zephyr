## boards/systech/rbs2530_cpu/Kconfig
```kconfig
#
# Copyright (c) 2024, SYSTech Co.
# SPDX-License-Identifier: Apache-2.0
#

config BOARD_RBS2530_CPU
	select SOC_FMSH_FMQL20
```

## boards/systech/rbs2530_cpu_old/Kconfig.rbs2530_cpu_old
```kconfig
#
# Copyright (c) 2024 SYSTech Co.
# SPDX-License-Identifier: Apache-2.0
#

config BOARD_RBS2530_CPU_OLD
	select SOC_FMSH_FMQL20
```

## boards/systech/rbs2530_ec/Kconfig.defconfig
```kconfig
#
# Copyright (c) 2024 SYSTech Co.
# SPDX-License-Identifier: Apache-2.0
#

if BOARD_RBS2530_EC

config BUILD_OUTPUT_BIN
	default n
config SYS_CLOCK_TICKS_PER_SEC
	default 1000

if LOG_PROCESS_THREAD

config LOG_PROCESS_THREAD_STACK_SIZE
	default 8192

endif # LOG_PROCESS_THREAD

if NETWORKING

config NET_L2_ETHERNET
	default y

config NET_TX_STACK_SIZE
	default 8192

config NET_RX_STACK_SIZE
	default 8192

if NET_TCP

config NET_TCP_WORKQ_STACK_SIZE
	default 8192

endif # NET_TCP

if NET_MGMT_EVENT

config NET_MGMT_EVENT_STACK_SIZE
	default 8192

endif # NET_MGMT_EVENT

config TEST_RANDOM_GENERATOR
	default y

endif # NETWORKING

config SHELL_STACK_SIZE
	default 8192 if SHELL

endif # BOARD_RBS2530_EC
```

## boards/systech/rbs2530_ec/Kconfig.rbs2530_ec
```kconfig
#
# Copyright (c) 2024 SYSTech Co.
# SPDX-License-Identifier: Apache-2.0
#

config BOARD_RBS2530_EC
	select SOC_FMSH_FMQL20
```

## boards/systech/rbs2530_ec/rbs2530_ec_defconfig
```kconfig
#
# Copyright (c) 2024 SYSTech Co.
#
# SPDX-License-Identifier: Apache-2.0
#
CONFIG_SYS_CLOCK_HW_CYCLES_PER_SEC=15000000
CONFIG_ARM_ARCH_TIMER=y

CONFIG_SERIAL=y
CONFIG_CONSOLE=y
CONFIG_UART_CONSOLE=y
```

## boards/systech/rbs2530_ext/Kconfig
```kconfig
#
# Copyright (c) 2024, SYSTech Co.
# SPDX-License-Identifier: Apache-2.0
#

config BOARD_RBS2530_EXT
	select SOC_FMSH_FMQL20
```

## boards/systech/rbs2530_sc1_v2/Kconfig
```kconfig
#
# Copyright (c) 2026, SYSFly Co.
# SPDX-License-Identifier: Apache-2.0
#

config BOARD_RBS2530_SC1_V2
	select SOC_FMSH_FMQL20
```

## boards/systech/rbs2530_sc1_v2/rbs2530_sc1_v2_defconfig
```kconfig
#
# Copyright (c) 2026 SYSFly Co.
#
# SPDX-License-Identifier: Apache-2.0
#
CONFIG_SYS_CLOCK_HW_CYCLES_PER_SEC=15000000
CONFIG_ARM_ARCH_TIMER=y

CONFIG_SERIAL=y
CONFIG_CONSOLE=y
CONFIG_UART_CONSOLE=y
CONFIG_IDLE_STACK_SIZE=2048
```

## boards/systech/rbs2530_sc2/Kconfig.rbs2530_sc2
```kconfig
#
# Copyright (c) 2024 SYSFly Co.
# SPDX-License-Identifier: Apache-2.0
#

config BOARD_RBS2530_SC2
	select SOC_FMSH_FMQL20
```
