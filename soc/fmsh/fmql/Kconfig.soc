## soc/fmsh/fmql/Kconfig.soc
```kconfig
#
# Copyright (c) 2021 Weidmueller Interface GmbH & Co. KG
# Copyright (c) 2024 SYSTech Co.
# SPDX-License-Identifier: Apache-2.0
#

config SOC_FAMILY_FMSH_FMQL
	bool

config SOC_FAMILY
	default "fmsh_fmql" if SOC_FAMILY_FMSH_FMQL

rsource "*/Kconfig.soc"
```

## soc/fmsh/fmql/fmql/Kconfig
```kconfig
#
# Copyright (c) 2021 Weidmueller Interface GmbH & Co. KG
# Copyright (c) 2024 SYSTech Co.
# SPDX-License-Identifier: Apache-2.0
#
#

config SOC_SERIES_FMSH_FMQL
	select ARM
	select CPU_CORTEX_A7
	select SYSCON
	select ARM_ARCH_TIMER_FMSH_CUSTOM if ARM_ARCH_TIMER
	select CLOCK_CONTROL
	select TIMER_READS_ITS_FREQUENCY_AT_RUNTIME
```

## soc/fmsh/fmql/fmql/Kconfig.soc
```kconfig
#
# Copyright (c) 2021 Weidmueller Interface GmbH & Co. KG
# Copyright (c) 2024 SYSTech Co.
# SPDX-License-Identifier: Apache-2.0
#

config SOC_SERIES_FMSH_FMQL
	bool
	select SOC_FAMILY_FMSH_FMQL
	help
	  Enable support for the FMSH FMQL SoC series.
	  SoC series based on the ARM Cortex-A7 quad core.

config SOC_FMSH_FMQL10
	bool
	select SOC_SERIES_FMSH_FMQL
	help
	  4 ARM cortex-A7 cores up to 800 MHz.
	  28k logic cells.

config SOC_FMSH_FMQL45
	bool
	select SOC_SERIES_FMSH_FMQL
	help
	  4 ARM cortex-A7 cores up to 800 MHz.
	  350k logic cells, with x16 GTX.

config SOC_FMSH_FMQL20
	bool
	select SOC_SERIES_FMSH_FMQL
	help
	  4 ARM cortex-A7 cores up to 800 MHz.
	  85k logic cells.

config SOC_FMSH_FMQL15
	bool
	select SOC_SERIES_FMSH_FMQL
	help
	  4 ARM cortex-A7 cores up to 800 MHz.
	  74k logic cells, with x4 GTX.

config SOC_SERIES
	default "fmql" if SOC_SERIES_FMSH_FMQL

config SOC
	default "fmql10" if SOC_FMSH_FMQL10
	default "fmql15" if SOC_FMSH_FMQL15
	default "fmql20" if SOC_FMSH_FMQL20
	default "fmql45" if SOC_FMSH_FMQL45
```

## subsys/debug/coredump/Kconfig
```kconfig
# Copyright (c) 2020 Intel Corporation.
# SPDX-License-Identifier: Apache-2.0

menuconfig DEBUG_COREDUMP
	bool "Core Dump"
	depends on ARCH_SUPPORTS_COREDUMP
	help
	  Enable core dump so it can be used for offline debugging.

if DEBUG_COREDUMP

choice DEBUG_COREDUMP_BACKEND
	prompt "Coredump backend"
	default DEBUG_COREDUMP_BACKEND_LOGGING

config DEBUG_COREDUMP_BACKEND_LOGGING
	bool "Use Logging subsystem for coredump"
	select LOG
	help
	  Core dump is done via logging subsystem.

config DEBUG_COREDUMP_BACKEND_FLASH_PARTITION
	bool "Use flash partition for coredump"
	depends on FLASH
	select FLASH_MAP
	select STREAM_FLASH
	help
	  Core dump is saved to a flash partition with DTS alias
	  "coredump-partition".

config DEBUG_COREDUMP_BACKEND_INTEL_ADSP_MEM_WINDOW
	bool "Use memory window for coredump on Intel ADSP"
	depends on DT_HAS_INTEL_ADSP_MEM_WINDOW_ENABLED
	help
	  Core dump is done via memory window slot[1].
	  It is Intel ADSP memory region shared with xtensa DSP.
	  Window 2 slot [1] is reserved for debuging information.

config DEBUG_COREDUMP_BACKEND_EMMC
	bool "Use eMMC storage for coredump"
	depends on DISK_ACCESS
	select MMC_STACK
	help
	  Core dump is saved to an eMMC partition with DTS alias
	  "coredump-partition". This backend uses disk access API
	  to write coredump data to eMMC storage.

	  IMPORTANT LIMITATION:
	  The eMMC backend is initialized at APPLICATION level during boot
	  sequence (just before main()). This means coredump will NOT work
	  for faults that occur during early boot stages (PRE_KERNEL_1,
	  PRE_KERNEL_2, POST_KERNEL). Only faults occurring after APPLICATION
	  initialization are captured.

	  This late initialization is intentional to ensure the disk subsystem
	  is fully ready before attempting eMMC access, as disk_access_init()
	  may block waiting for hardware and could hang in fault context if
	  called too early.

	  For maximum fault coverage including early boot, consider using
	  DEBUG_COREDUMP_BACKEND_FLASH_PARTITION instead, which initializes
	  earlier in the boot sequence.

config DEBUG_COREDUMP_BACKEND_OTHER
	bool "Backend subsystem for coredump defined out of tree"
	help
	  Core dump is done via custom mechanism defined out of tree

endchoice

choice DEBUG_COREDUMP_MEMORY_DUMP
	prompt "Memory dump"
	default DEBUG_COREDUMP_MEMORY_DUMP_LINKER_RAM

config DEBUG_COREDUMP_MEMORY_DUMP_MIN
	bool "Minimal"
	select THREAD_STACK_INFO
	help
	  Only dumps the bare minimum memory content.
	  For example, the thread struct and stack of
	  the exception thread will be dumped.

	  Don't use this unless you want absolutely
	  minimum core dump.

config DEBUG_COREDUMP_MEMORY_DUMP_THREADS
	bool "Threads"
	depends on !SMP
	depends on ARCH_SUPPORTS_COREDUMP_THREADS
	select THREAD_STACK_INFO
	select DEBUG_THREAD_INFO
	select DEBUG_COREDUMP_THREADS_METADATA
	help
	  Dumps the thread struct and stack of all
	  threads and all data required to debug threads.

config DEBUG_COREDUMP_MEMORY_DUMP_LINKER_RAM
	bool "RAM defined by linker section"
	help
	  Dumps the memory region between _image_ram_start[]
	  and _image_ram_end[]. This includes at least data,
	  noinit, and BSS sections.

	  This is the default.

endchoice

if DEBUG_COREDUMP_BACKEND_FLASH_PARTITION

config DEBUG_COREDUMP_FLASH_CHUNK_SIZE
	int "Chunk size for flash write operations"
	default 64
	help
	  Larger values can speed up writing due to fewer write operations
	  being performed in total, but consume more memory.


endif # DEBUG_COREDUMP_BACKEND_FLASH_PARTITION

if DEBUG_COREDUMP_BACKEND_EMMC

config DEBUG_COREDUMP_EMMC_CHUNK_SIZE
	int "Chunk size for eMMC write operations"
	default 512
	help
	  Larger values can speed up writing due to fewer write operations
	  being performed in total, but consume more memory.
	  Must be a multiple of eMMC sector size (typically 512 bytes).

config DEBUG_COREDUMP_EMMC_DEVICE_NAME
	string "eMMC device name"
	default "MMC"
	help
	  The name of the eMMC device to use for coredump storage.
	  This should match the disk access device name.

endif # DEBUG_COREDUMP_BACKEND_EMMC

config DEBUG_COREDUMP_SHELL
	bool "Coredump shell"
	depends on SHELL
	help
	  This shell provides access to coredump and its backends.

config DEBUG_COREDUMP_THREADS_METADATA
	bool "Threads metadata"
	depends on !SMP
	depends on ARCH_SUPPORTS_COREDUMP_THREADS
	select DEBUG_THREAD_INFO
	help
	  Core dump will contain the threads metadata section containing
	  any necessary data to enable debugging threads

config DEBUG_COREDUMP_DUMP_THREAD_PRIV_STACK
	bool "Dump privilege stack of user threads"
	default y
	depends on ARCH_SUPPORTS_COREDUMP_PRIV_STACKS
	depends on USERSPACE
	help
	  Dump the privilege stack of user threads.

	  Say n to conserve space on coredump backend or if you will never
	  need to look into the privilege stacks.

endif # DEBUG_COREDUMP
```

## subsys/disk/disk_tools/Kconfig
```kconfig
# Copyright (c) 2026 SYSTech Co.
# SPDX-License-Identifier: Apache-2.0

menuconfig DISK_TOOLS
	bool "Disk Tools"
	depends on DISK_ACCESS
	depends on SHELL
	help
	  Enable disk tools for reading and transferring disk data
	  via command line interface. Supports reading from various
	  storage devices like eMMC, Flash, etc.

if DISK_TOOLS

config DISK_TOOLS_BUFFER_SIZE
	int "Disk tools buffer size"
	default 16384
	help
	  Buffer size for disk read operations. Larger buffer size
	  improves network transfer performance. Default 16KB.
	  Should be multiple of disk sector size (typically 512 bytes).

config DISK_TOOLS_MAX_TRANSFER_SIZE
	int "Maximum transfer size in bytes"
	default 1073741824
	help
	  Maximum size of data that can be transferred in one operation.
	  Default is 1GB.

config DISK_TOOLS_NETWORK
	bool "Network transfer support"
	depends on NETWORKING
	depends on NET_SOCKETS
	depends on NET_TCP
	help
	  Enable network transfer capability to send disk data over TCP.
	  Compatible with coredump_client.py protocol.

if DISK_TOOLS_NETWORK

config DISK_TOOLS_NET_PORT
	int "Network server port"
	default 9999
	help
	  TCP port for disk data transfer server.

config DISK_TOOLS_NET_STACK_SIZE
	int "Network server thread stack size"
	default 4096
	help
	  Stack size for the network transfer server thread.
	  Should be at least 4KB for basic operation.

config DISK_TOOLS_NET_THREAD_PRIORITY
	int "Network server thread priority"
	default 5
	help
	  Priority for the network transfer server thread.

config DISK_TOOLS_NET_TIMEOUT_MS
	int "Network operation timeout in milliseconds"
	default 30000
	help
	  Timeout for network send/receive operations.

endif # DISK_TOOLS_NETWORK

module = DISK_TOOLS
module-str = disk_tools
source "subsys/logging/Kconfig.template.log_config"

endif # DISK_TOOLS
```

## subsys/net/lib/sockets/ldp/Kconfig
```kconfig
# LDP (low data protocol for custom back-plane bus) support

# Copyright (c) 2025 SYSTech Co.
# SPDX-License-Identifier: Apache-2.0
#
#
config LDP
	bool "LDP support"
	default n
	select MCB
	select CPP
	select REQUIRES_FULL_LIBCPP
	select PTHREAD_IPC
	help
	  This option enables LDP support
	  and is the basis for higher level protocols (e.g. LDP protocols).

config LDP_MAX_HARQ
	int "Maximum LDP HARQ depth"
	depends on LDP
	default 4
	range 1 128
	help
	  This option specifies the maximum depth of the LDP HARQ FIFO buffer.
	  A larger value allows for more packets to be queued for retransmission
	  but consumes more memory.

config CIF_ASYNC_BOOTSTRAP_CREDITS
	int "Initial CIF async bandwidth-control credits"
	depends on LDP
	default 5
	range 3 5
	help
	  Give each newly created async connection this many one-time initial
	  transfer credits. These credits allow a bounded startup burst before
	  periodic bandwidth-control allocation becomes available. After they
	  are exhausted, regular bandwidth control still applies.

config CIF_WQ_NORMAL_MAX_OVERDUE_US
	int "Maximum CIF normal work item overdue time"
	depends on LDP
	default 100000
	range 1 2147483647
	help
	  Force one overdue normal-priority work item before continuing due
	  high-priority work when lateness is strictly greater than this value.

config CIF_WQ_DIAGNOSTIC_REPORT_INTERVAL_MS
	int "CIF work queue diagnostic report interval"
	depends on LDP
	default 1000
	range 100 60000
	help
	  Report continuing callback overruns and forced normal dispatches no more
	  than once per interval. First events are reported immediately.
```

## subsys/uboot/Kconfig
```kconfig
# Copyright (c) 2025 SYSFly Co.
# SPDX-License-Identifier: Apache-2.0

menuconfig UBOOT
	bool "U-boot utilities"
	help
	  Enable support for U-boot utilities.

if UBOOT

module = UBOOT
module-str = UBOOT
source "subsys/logging/Kconfig.template.log_config"

config UBOOT_ENV
	bool "U-boot environment"
	default y
	depends on FLASH
	select CRC
	select FLASH_MAP
	select STREAM_FLASH
	select GNU_C_EXTENSIONS
	help
	  Enable support for managing U-boot environment.

if UBOOT_ENV
config UBOOT_ENV_REDUNDANT
	bool "Redundant env support"
	help
	  Enable support for redundant U-boot environment.
endif # UBOOT_ENV

endif # UBOOT
```

## tests/subsys/fs/littlefs/disk_partition/testcase.yaml
```yaml
common:
  tags:
    - filesystem
    - littlefs
  modules:
    - littlefs
tests:
  filesystem.littlefs.disk_partition:
    platform_allow:
      - qemu_x86_64
    integration_platforms:
      - qemu_x86_64
    timeout: 120
```
